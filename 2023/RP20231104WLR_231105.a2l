/******************************************************************************
* ASAP2 file: RP20231104WLR_231105.a2l
* Code generation for model "RP20231104WLR_231105".
* Model version : 1.1
* Simulink Coder version : 9.2 (R2019b) 18-Jul-2019
* C source code generated on : Wed Sep 18 01:37:23 2024
* Target selection: ec5744.tlc
* Embedded hardware selection: Freescale MPC5500
* Code generation objectives: Unspecified
* Validation result: Not run
* (add additional file header information here)
******************************************************************************/ ASAP2_VERSION 1 31
/* Version 1.31 */
/begin PROJECT ECUCoderProject "ECUCoder Project"
/begin HEADER "Header Comments go here" /end HEADER
/begin MODULE ModuleName "Module Comment Goes Here"
/begin MOD_PAR "MOD PAR Comment Goes Here" /end MOD_PAR
/begin MOD_COMMON "Mod Common Comment Here" BYTE_ORDER MSB_FIRST /end MOD_COMMON
/begin RECORD_LAYOUT Scalar_BOOLEAN FNC_VALUES 1 UBYTE COLUMN_DIR DIRECT /end RECORD_LAYOUT
/begin RECORD_LAYOUT Scalar_UBYTE FNC_VALUES 1 UBYTE COLUMN_DIR DIRECT /end RECORD_LAYOUT
/begin RECORD_LAYOUT Scalar_BYTE FNC_VALUES 1 SBYTE COLUMN_DIR DIRECT /end RECORD_LAYOUT
/begin RECORD_LAYOUT Scalar_UWORD FNC_VALUES 1 UWORD COLUMN_DIR DIRECT /end RECORD_LAYOUT
/begin RECORD_LAYOUT Scalar_SWORD FNC_VALUES 1 SWORD COLUMN_DIR DIRECT /end RECORD_LAYOUT
/begin RECORD_LAYOUT Scalar_ULONG FNC_VALUES 1 ULONG COLUMN_DIR DIRECT /end RECORD_LAYOUT
/begin RECORD_LAYOUT Scalar_LONG FNC_VALUES 1 SLONG COLUMN_DIR DIRECT /end RECORD_LAYOUT
/begin RECORD_LAYOUT Scalar_FLOAT32_IEEE FNC_VALUES 1 FLOAT32_IEEE COLUMN_DIR DIRECT /end RECORD_LAYOUT
/begin RECORD_LAYOUT Scalar_FLOAT64_IEEE FNC_VALUES 1 FLOAT64_IEEE COLUMN_DIR DIRECT /end RECORD_LAYOUT
/begin RECORD_LAYOUT Lookup1D_BOOLEAN FNC_VALUES 1 UBYTE COLUMN_DIR DIRECT /end RECORD_LAYOUT
/begin RECORD_LAYOUT Lookup1D_X_BOOLEAN AXIS_PTS_X 1 UBYTE INDEX_INCR DIRECT /end RECORD_LAYOUT
/begin RECORD_LAYOUT Lookup1D_BYTE FNC_VALUES 1 SBYTE COLUMN_DIR DIRECT /end RECORD_LAYOUT
/begin RECORD_LAYOUT Lookup1D_X_BYTE AXIS_PTS_X 1 SBYTE INDEX_INCR DIRECT /end RECORD_LAYOUT
/begin RECORD_LAYOUT Lookup1D_UBYTE FNC_VALUES 1 UBYTE COLUMN_DIR DIRECT /end RECORD_LAYOUT
/begin RECORD_LAYOUT Lookup1D_X_UBYTE AXIS_PTS_X 1 UBYTE INDEX_INCR DIRECT /end RECORD_LAYOUT
/begin RECORD_LAYOUT Lookup1D_UWORD FNC_VALUES 1 UWORD COLUMN_DIR DIRECT /end RECORD_LAYOUT
/begin RECORD_LAYOUT Lookup1D_X_UWORD AXIS_PTS_X 1 UWORD INDEX_INCR DIRECT /end RECORD_LAYOUT
/begin RECORD_LAYOUT Lookup1D_WORD FNC_VALUES 1 SWORD COLUMN_DIR DIRECT /end RECORD_LAYOUT
/begin RECORD_LAYOUT Lookup1D_X_WORD AXIS_PTS_X 1 SWORD INDEX_INCR DIRECT /end RECORD_LAYOUT
/begin RECORD_LAYOUT Lookup1D_ULONG FNC_VALUES 1 ULONG COLUMN_DIR DIRECT /end RECORD_LAYOUT
/begin RECORD_LAYOUT Lookup1D_X_ULONG AXIS_PTS_X 1 ULONG INDEX_INCR DIRECT /end RECORD_LAYOUT
/begin RECORD_LAYOUT Lookup1D_SLONG FNC_VALUES 1 SLONG COLUMN_DIR DIRECT /end RECORD_LAYOUT
/begin RECORD_LAYOUT Lookup1D_X_LONG AXIS_PTS_X 1 SLONG INDEX_INCR DIRECT /end RECORD_LAYOUT
/begin RECORD_LAYOUT Lookup1D_FLOAT32_IEEE FNC_VALUES 1 FLOAT32_IEEE COLUMN_DIR DIRECT /end RECORD_LAYOUT
/begin RECORD_LAYOUT Lookup1D_X_FLOAT32_IEEE AXIS_PTS_X 1 FLOAT32_IEEE INDEX_INCR DIRECT /end RECORD_LAYOUT
/begin RECORD_LAYOUT Lookup1D_FLOAT64_IEEE FNC_VALUES 1 FLOAT64_IEEE COLUMN_DIR DIRECT /end RECORD_LAYOUT
/begin RECORD_LAYOUT Lookup1D_X_FLOAT64_IEEE AXIS_PTS_X 1 FLOAT64_IEEE INDEX_INCR DIRECT /end RECORD_LAYOUT
/begin RECORD_LAYOUT Lookup2D_BOOLEAN FNC_VALUES 1 UBYTE COLUMN_DIR DIRECT /end RECORD_LAYOUT
/begin RECORD_LAYOUT Lookup2D_X_BOOLEAN AXIS_PTS_X 1 UBYTE INDEX_INCR DIRECT /end RECORD_LAYOUT
/begin RECORD_LAYOUT Lookup2D_UBYTE FNC_VALUES 1 UBYTE COLUMN_DIR DIRECT /end RECORD_LAYOUT
/begin RECORD_LAYOUT Lookup2D_X_UBYTE AXIS_PTS_X 1 UBYTE INDEX_INCR DIRECT /end RECORD_LAYOUT
/begin RECORD_LAYOUT Lookup2D_BYTE FNC_VALUES 1 SBYTE COLUMN_DIR DIRECT /end RECORD_LAYOUT
/begin RECORD_LAYOUT Lookup2D_X_BYTE AXIS_PTS_X 1 SBYTE INDEX_INCR DIRECT /end RECORD_LAYOUT
/begin RECORD_LAYOUT Lookup2D_UWORD FNC_VALUES 1 UWORD COLUMN_DIR DIRECT /end RECORD_LAYOUT
/begin RECORD_LAYOUT Lookup2D_X_UWORD AXIS_PTS_X 1 UWORD INDEX_INCR DIRECT /end RECORD_LAYOUT
/begin RECORD_LAYOUT Lookup2D_WORD FNC_VALUES 1 SWORD COLUMN_DIR DIRECT /end RECORD_LAYOUT
/begin RECORD_LAYOUT Lookup2D_X_WORD AXIS_PTS_X 1 SWORD INDEX_INCR DIRECT /end RECORD_LAYOUT
/begin RECORD_LAYOUT Lookup2D_ULONG FNC_VALUES 1 ULONG COLUMN_DIR DIRECT /end RECORD_LAYOUT
/begin RECORD_LAYOUT Lookup2D_X_ULONG AXIS_PTS_X 1 ULONG INDEX_INCR DIRECT /end RECORD_LAYOUT
/begin RECORD_LAYOUT Lookup2D_LONG FNC_VALUES 1 SLONG COLUMN_DIR DIRECT /end RECORD_LAYOUT
/begin RECORD_LAYOUT Lookup2D_X_LONG AXIS_PTS_X 1 SLONG INDEX_INCR DIRECT /end RECORD_LAYOUT
/begin RECORD_LAYOUT Lookup2D_FLOAT32_IEEE FNC_VALUES 1 FLOAT32_IEEE COLUMN_DIR DIRECT /end RECORD_LAYOUT
/begin RECORD_LAYOUT Lookup2D_X_FLOAT32_IEEE AXIS_PTS_X 1 FLOAT32_IEEE INDEX_INCR DIRECT /end RECORD_LAYOUT
/begin RECORD_LAYOUT Lookup2D_FLOAT64_IEEE FNC_VALUES 1 FLOAT64_IEEE COLUMN_DIR DIRECT /end RECORD_LAYOUT
/begin RECORD_LAYOUT Lookup2D_X_FLOAT64_IEEE AXIS_PTS_X 1 FLOAT64_IEEE INDEX_INCR DIRECT /end RECORD_LAYOUT
/begin MEASUREMENT RP20231104WLR_231105_B.LVMS "" UBYTE RP20231104WLR_231105_CM_boolean 0 0 0 1 ECU_ADDRESS 0x0000 /* @ECU_Address@RP20231104WLR_231105_B.LVMS@ */ /end MEASUREMENT
/begin MEASUREMENT Gear_Trs "" FLOAT64_IEEE RP20231104WLR_231105_CM_double 0 0 -1.7E+308 1.7E+308 ECU_ADDRESS 0x0000 /* @ECU_Address@Gear_Trs@ */ /end MEASUREMENT
/begin MEASUREMENT Mode_Trs "" FLOAT64_IEEE RP20231104WLR_231105_CM_double 0 0 -1.7E+308 1.7E+308 ECU_ADDRESS 0x0000 /* @ECU_Address@Mode_Trs@ */ /end MEASUREMENT
/begin MEASUREMENT L12V_error "" FLOAT64_IEEE RP20231104WLR_231105_CM_double 0 0 -1.7E+308 1.7E+308 ECU_ADDRESS 0x0000 /* @ECU_Address@L12V_error@ */ /end MEASUREMENT
/begin MEASUREMENT alarm "" FLOAT64_IEEE RP20231104WLR_231105_CM_double 0 0 -1.7E+308 1.7E+308 ECU_ADDRESS 0x0000 /* @ECU_Address@alarm@ */ /end MEASUREMENT
/begin MEASUREMENT controller_ready "" FLOAT64_IEEE RP20231104WLR_231105_CM_double 0 0 -1.7E+308 1.7E+308 ECU_ADDRESS 0x0000 /* @ECU_Address@controller_ready@ */ /end MEASUREMENT
/begin MEASUREMENT selfcheck "" FLOAT64_IEEE RP20231104WLR_231105_CM_double 0 0 -1.7E+308 1.7E+308 ECU_ADDRESS 0x0000 /* @ECU_Address@selfcheck@ */ /end MEASUREMENT
/begin MEASUREMENT RPM "" FLOAT64_IEEE RP20231104WLR_231105_CM_double 0 0 -1.7E+308 1.7E+308 ECU_ADDRESS 0x0000 /* @ECU_Address@RPM@ */ /end MEASUREMENT
/begin MEASUREMENT trq "" FLOAT64_IEEE RP20231104WLR_231105_CM_double 0 0 -1.7E+308 1.7E+308 ECU_ADDRESS 0x0000 /* @ECU_Address@trq@ */ /end MEASUREMENT
/begin MEASUREMENT Spd_R "" FLOAT64_IEEE RP20231104WLR_231105_CM_double 0 0 -1.7E+308 1.7E+308 ECU_ADDRESS 0x0000 /* @ECU_Address@Spd_R@ */ /end MEASUREMENT
/begin MEASUREMENT motor_power "" FLOAT64_IEEE RP20231104WLR_231105_CM_double 0 0 -1.7E+308 1.7E+308 ECU_ADDRESS 0x0000 /* @ECU_Address@motor_power@ */ /end MEASUREMENT
/begin MEASUREMENT Wheel_spd_F "" FLOAT64_IEEE RP20231104WLR_231105_CM_double 0 0 -1.7E+308 1.7E+308 ECU_ADDRESS 0x0000 /* @ECU_Address@Wheel_spd_F@ */ /end MEASUREMENT
/begin MEASUREMENT VCU_SpdCmd "" FLOAT64_IEEE RP20231104WLR_231105_CM_double 0 0 -1.7E+308 1.7E+308 ECU_ADDRESS 0x0000 /* @ECU_Address@VCU_SpdCmd@ */ /end MEASUREMENT
/begin MEASUREMENT Brk_F_vol "" ULONG RP20231104WLR_231105_CM_uint32 0 0 0 4294967295 ECU_ADDRESS 0x0000 /* @ECU_Address@Brk_F_vol@ */ /end MEASUREMENT
/begin MEASUREMENT Brk_R_vol "" ULONG RP20231104WLR_231105_CM_uint32 0 0 0 4294967295 ECU_ADDRESS 0x0000 /* @ECU_Address@Brk_R_vol@ */ /end MEASUREMENT
/begin MEASUREMENT R_BrkPrs "" ULONG RP20231104WLR_231105_CM_uint32 0 0 0 4294967295 ECU_ADDRESS 0x0000 /* @ECU_Address@R_BrkPrs@ */ /end MEASUREMENT
/begin MEASUREMENT F_BrkPrs "" ULONG RP20231104WLR_231105_CM_uint32 0 0 0 4294967295 ECU_ADDRESS 0x0000 /* @ECU_Address@F_BrkPrs@ */ /end MEASUREMENT
/begin MEASUREMENT Acc_vol "" ULONG RP20231104WLR_231105_CM_ufix32_En16 0 0 0 65535.999984741211 ECU_ADDRESS 0x0000 /* @ECU_Address@Acc_vol@ */ /end MEASUREMENT
/begin MEASUREMENT Acc_vol2 "" ULONG RP20231104WLR_231105_CM_ufix32_En16 0 0 0 65535.999984741211 ECU_ADDRESS 0x0000 /* @ECU_Address@Acc_vol2@ */ /end MEASUREMENT
/begin MEASUREMENT Acc_POS1 "" ULONG RP20231104WLR_231105_CM_ufix32_En16 0 0 0 65535.999984741211 ECU_ADDRESS 0x0000 /* @ECU_Address@Acc_POS1@ */ /end MEASUREMENT
/begin MEASUREMENT Acc_POS2 "" ULONG RP20231104WLR_231105_CM_ufix32_En16 0 0 0 65535.999984741211 ECU_ADDRESS 0x0000 /* @ECU_Address@Acc_POS2@ */ /end MEASUREMENT
/begin MEASUREMENT AC_current "" FLOAT32_IEEE RP20231104WLR_231105_CM_single 0 0 -3.4E+38 3.4E+38 ECU_ADDRESS 0x0000 /* @ECU_Address@AC_current@ */ /end MEASUREMENT
/begin MEASUREMENT DC_current "" FLOAT32_IEEE RP20231104WLR_231105_CM_single 0 0 -3.4E+38 3.4E+38 ECU_ADDRESS 0x0000 /* @ECU_Address@DC_current@ */ /end MEASUREMENT
/begin MEASUREMENT MCU_Temp "" FLOAT32_IEEE RP20231104WLR_231105_CM_single 0 0 -3.4E+38 3.4E+38 ECU_ADDRESS 0x0000 /* @ECU_Address@MCU_Temp@ */ /end MEASUREMENT
/begin MEASUREMENT motor_Temp "" FLOAT32_IEEE RP20231104WLR_231105_CM_single 0 0 -3.4E+38 3.4E+38 ECU_ADDRESS 0x0000 /* @ECU_Address@motor_Temp@ */ /end MEASUREMENT
/begin MEASUREMENT VCU_TrqCmd "" FLOAT32_IEEE RP20231104WLR_231105_CM_single 0 0 -3.4E+38 3.4E+38 ECU_ADDRESS 0x0000 /* @ECU_Address@VCU_TrqCmd@ */ /end MEASUREMENT
/begin MEASUREMENT VehReady "" UBYTE RP20231104WLR_231105_CM_boolean 0 0 0 1 ECU_ADDRESS 0x0000 /* @ECU_Address@VehReady@ */ /end MEASUREMENT
/begin MEASUREMENT beeper_state "" UBYTE RP20231104WLR_231105_CM_boolean 0 0 0 1 ECU_ADDRESS 0x0000 /* @ECU_Address@beeper_state@ */ /end MEASUREMENT
/begin MEASUREMENT ignition "" UBYTE RP20231104WLR_231105_CM_boolean 0 0 0 1 ECU_ADDRESS 0x0000 /* @ECU_Address@ignition@ */ /end MEASUREMENT
/begin MEASUREMENT Trq_CUT "" UBYTE RP20231104WLR_231105_CM_boolean 0 0 0 1 ECU_ADDRESS 0x0000 /* @ECU_Address@Trq_CUT@ */ /end MEASUREMENT
/begin COMPU_METHOD RP20231104WLR_231105_CM_boolean "Q = V" RAT_FUNC "%1.0" "" COEFFS 0 1 0 0 0 1 /end COMPU_METHOD
/begin COMPU_METHOD RP20231104WLR_231105_CM_double "Q = V" RAT_FUNC "%15.10" "" COEFFS 0 1 0 0 0 1 /end COMPU_METHOD
/begin COMPU_METHOD RP20231104WLR_231105_CM_uint32 "Q = V" RAT_FUNC "%10.0" "" COEFFS 0 1 0 0 0 1 /end COMPU_METHOD
/begin COMPU_METHOD RP20231104WLR_231105_CM_ufix32_En16 "Q = V*65536.000000" RAT_FUNC "%26.16" "" COEFFS 0 65536.000000 0.000000 0 0 1.000000 /end COMPU_METHOD
/begin COMPU_METHOD RP20231104WLR_231105_CM_single "Q = V" RAT_FUNC "%8.6" "" COEFFS 0 1 0 0 0 1 /end COMPU_METHOD
/begin GROUP RP20231104WLR_231105 "RP20231104WLR_231105" /* Root */ ROOT /begin SUB_GROUP Root_Ctrl Root_Input Root_Output Root_drive_ready /end SUB_GROUP /end GROUP
/begin GROUP Root_Ctrl "RP20231104WLR_231105/Ctrl" /begin SUB_GROUP S1_MoTrqReq /end SUB_GROUP /end GROUP
/begin GROUP Root_Input "RP20231104WLR_231105/Input"
 /begin SUB_GROUP S3_AccBrk_BUS S3_Function_Call_Subsystem1 S3_MCU_RECIEVE S3_key /end SUB_GROUP
/end GROUP
/begin GROUP Root_Output "RP20231104WLR_231105/Output" /begin SUB_GROUP S4_VCU2MCU /end SUB_GROUP /end GROUP
/begin GROUP Root_drive_ready "RP20231104WLR_231105/drive_ready" /begin SUB_GROUP S6_Drive_ready /end SUB_GROUP /end GROUP
/begin GROUP S1_MoTrqReq "RP20231104WLR_231105/Ctrl/MoTrqReq" /begin REF_MEASUREMENT VCU_SpdCmd VCU_TrqCmd /end REF_MEASUREMENT /end GROUP
/begin GROUP S3_AccBrk_BUS "RP20231104WLR_231105/Input/AccBrk_BUS" /begin SUB_GROUP S23_LowPass2 S23_LowPass4 /end SUB_GROUP
 /begin REF_MEASUREMENT Acc_POS1 Acc_POS2 Acc_vol Acc_vol2 F_BrkPrs R_BrkPrs Trq_CUT /end REF_MEASUREMENT
/end GROUP
/begin GROUP S3_Function_Call_Subsystem1 "RP20231104WLR_231105/Input/Function-Call Subsystem1" /begin REF_MEASUREMENT Wheel_spd_F /end REF_MEASUREMENT /end GROUP
/begin GROUP S3_MCU_RECIEVE "RP20231104WLR_231105/Input/MCU_RECIEVE" /begin SUB_GROUP S25_MCU_pwr S25_MCU_state /end SUB_GROUP /end GROUP
/begin GROUP S3_key "RP20231104WLR_231105/Input/key" /begin REF_MEASUREMENT RP20231104WLR_231105_B.LVMS ignition /end REF_MEASUREMENT /end GROUP
/begin GROUP S4_VCU2MCU "RP20231104WLR_231105/Output/VCU2MCU" /begin REF_MEASUREMENT Gear_Trs Mode_Trs /end REF_MEASUREMENT /end GROUP
/begin GROUP S6_Drive_ready "RP20231104WLR_231105/drive_ready/Drive_ready" /begin REF_MEASUREMENT VehReady beeper_state /end REF_MEASUREMENT /end GROUP
/begin GROUP S23_LowPass2 "RP20231104WLR_231105/Input/AccBrk_BUS/LowPass2" /begin REF_MEASUREMENT Brk_F_vol /end REF_MEASUREMENT /end GROUP
/begin GROUP S23_LowPass4 "RP20231104WLR_231105/Input/AccBrk_BUS/LowPass4" /begin REF_MEASUREMENT Brk_R_vol /end REF_MEASUREMENT /end GROUP
/begin GROUP S25_MCU_pwr "RP20231104WLR_231105/Input/MCU_RECIEVE/MCU_pwr" /begin SUB_GROUP S50_MCU_VCUMeter1 /end SUB_GROUP /end GROUP
/begin GROUP S25_MCU_state "RP20231104WLR_231105/Input/MCU_RECIEVE/MCU_state" /begin SUB_GROUP S51_MCU_state /end SUB_GROUP /end GROUP
/begin GROUP S50_MCU_VCUMeter1 "RP20231104WLR_231105/Input/MCU_RECIEVE/MCU_pwr/MCU_VCUMeter1" /begin REF_MEASUREMENT AC_current DC_current MCU_Temp motor_Temp motor_power /end REF_MEASUREMENT /end GROUP
/begin GROUP S51_MCU_state "RP20231104WLR_231105/Input/MCU_RECIEVE/MCU_state/MCU_state" /begin REF_MEASUREMENT L12V_error RPM Spd_R alarm controller_ready selfcheck trq /end REF_MEASUREMENT /end GROUP
/end MODULE
/end PROJECT
/* (add any file trailer comments here) */
/* EOF RP20231104WLR_231105.a2l */
