/******************************************************************************
* ASAP2 file: VehCtrlMdel240918_2018b.a2l
* Code generation for model "VehCtrlMdel240918_2018b".
* Model version : 1.131
* Simulink Coder version : 9.2 (R2019b) 18-Jul-2019
* C source code generated on : Sat Sep 21 02:12:35 2024
* Target selection: ec5744.tlc
* Embedded hardware selection: Freescale MPC5500
* Code generation objectives: Unspecified
* Validation result: Not run
* (add additional file header information here)
******************************************************************************/ ASAP2_VERSION 1 31
/* Version 1.31 */
/begin PROJECT ECUCoderProject "ECUCoder Project"
/begin HEADER "Header Comments go here" /end HEADER
/begin MODULE ModuleName "Module Comment Goes Here"
/begin MOD_PAR "MOD PAR Comment Goes Here" /end MOD_PAR
/begin MOD_COMMON "Mod Common Comment Here" BYTE_ORDER MSB_FIRST /end MOD_COMMON
/begin RECORD_LAYOUT Scalar_BOOLEAN FNC_VALUES 1 UBYTE COLUMN_DIR DIRECT /end RECORD_LAYOUT
/begin RECORD_LAYOUT Scalar_UBYTE FNC_VALUES 1 UBYTE COLUMN_DIR DIRECT /end RECORD_LAYOUT
/begin RECORD_LAYOUT Scalar_BYTE FNC_VALUES 1 SBYTE COLUMN_DIR DIRECT /end RECORD_LAYOUT
/begin RECORD_LAYOUT Scalar_UWORD FNC_VALUES 1 UWORD COLUMN_DIR DIRECT /end RECORD_LAYOUT
/begin RECORD_LAYOUT Scalar_SWORD FNC_VALUES 1 SWORD COLUMN_DIR DIRECT /end RECORD_LAYOUT
/begin RECORD_LAYOUT Scalar_ULONG FNC_VALUES 1 ULONG COLUMN_DIR DIRECT /end RECORD_LAYOUT
/begin RECORD_LAYOUT Scalar_LONG FNC_VALUES 1 SLONG COLUMN_DIR DIRECT /end RECORD_LAYOUT
/begin RECORD_LAYOUT Scalar_FLOAT32_IEEE FNC_VALUES 1 FLOAT32_IEEE COLUMN_DIR DIRECT /end RECORD_LAYOUT
/begin RECORD_LAYOUT Scalar_FLOAT64_IEEE FNC_VALUES 1 FLOAT64_IEEE COLUMN_DIR DIRECT /end RECORD_LAYOUT
/begin RECORD_LAYOUT Lookup1D_BOOLEAN FNC_VALUES 1 UBYTE COLUMN_DIR DIRECT /end RECORD_LAYOUT
/begin RECORD_LAYOUT Lookup1D_X_BOOLEAN AXIS_PTS_X 1 UBYTE INDEX_INCR DIRECT /end RECORD_LAYOUT
/begin RECORD_LAYOUT Lookup1D_BYTE FNC_VALUES 1 SBYTE COLUMN_DIR DIRECT /end RECORD_LAYOUT
/begin RECORD_LAYOUT Lookup1D_X_BYTE AXIS_PTS_X 1 SBYTE INDEX_INCR DIRECT /end RECORD_LAYOUT
/begin RECORD_LAYOUT Lookup1D_UBYTE FNC_VALUES 1 UBYTE COLUMN_DIR DIRECT /end RECORD_LAYOUT
/begin RECORD_LAYOUT Lookup1D_X_UBYTE AXIS_PTS_X 1 UBYTE INDEX_INCR DIRECT /end RECORD_LAYOUT
/begin RECORD_LAYOUT Lookup1D_UWORD FNC_VALUES 1 UWORD COLUMN_DIR DIRECT /end RECORD_LAYOUT
/begin RECORD_LAYOUT Lookup1D_X_UWORD AXIS_PTS_X 1 UWORD INDEX_INCR DIRECT /end RECORD_LAYOUT
/begin RECORD_LAYOUT Lookup1D_WORD FNC_VALUES 1 SWORD COLUMN_DIR DIRECT /end RECORD_LAYOUT
/begin RECORD_LAYOUT Lookup1D_X_WORD AXIS_PTS_X 1 SWORD INDEX_INCR DIRECT /end RECORD_LAYOUT
/begin RECORD_LAYOUT Lookup1D_ULONG FNC_VALUES 1 ULONG COLUMN_DIR DIRECT /end RECORD_LAYOUT
/begin RECORD_LAYOUT Lookup1D_X_ULONG AXIS_PTS_X 1 ULONG INDEX_INCR DIRECT /end RECORD_LAYOUT
/begin RECORD_LAYOUT Lookup1D_SLONG FNC_VALUES 1 SLONG COLUMN_DIR DIRECT /end RECORD_LAYOUT
/begin RECORD_LAYOUT Lookup1D_X_LONG AXIS_PTS_X 1 SLONG INDEX_INCR DIRECT /end RECORD_LAYOUT
/begin RECORD_LAYOUT Lookup1D_FLOAT32_IEEE FNC_VALUES 1 FLOAT32_IEEE COLUMN_DIR DIRECT /end RECORD_LAYOUT
/begin RECORD_LAYOUT Lookup1D_X_FLOAT32_IEEE AXIS_PTS_X 1 FLOAT32_IEEE INDEX_INCR DIRECT /end RECORD_LAYOUT
/begin RECORD_LAYOUT Lookup1D_FLOAT64_IEEE FNC_VALUES 1 FLOAT64_IEEE COLUMN_DIR DIRECT /end RECORD_LAYOUT
/begin RECORD_LAYOUT Lookup1D_X_FLOAT64_IEEE AXIS_PTS_X 1 FLOAT64_IEEE INDEX_INCR DIRECT /end RECORD_LAYOUT
/begin RECORD_LAYOUT Lookup2D_BOOLEAN FNC_VALUES 1 UBYTE COLUMN_DIR DIRECT /end RECORD_LAYOUT
/begin RECORD_LAYOUT Lookup2D_X_BOOLEAN AXIS_PTS_X 1 UBYTE INDEX_INCR DIRECT /end RECORD_LAYOUT
/begin RECORD_LAYOUT Lookup2D_UBYTE FNC_VALUES 1 UBYTE COLUMN_DIR DIRECT /end RECORD_LAYOUT
/begin RECORD_LAYOUT Lookup2D_X_UBYTE AXIS_PTS_X 1 UBYTE INDEX_INCR DIRECT /end RECORD_LAYOUT
/begin RECORD_LAYOUT Lookup2D_BYTE FNC_VALUES 1 SBYTE COLUMN_DIR DIRECT /end RECORD_LAYOUT
/begin RECORD_LAYOUT Lookup2D_X_BYTE AXIS_PTS_X 1 SBYTE INDEX_INCR DIRECT /end RECORD_LAYOUT
/begin RECORD_LAYOUT Lookup2D_UWORD FNC_VALUES 1 UWORD COLUMN_DIR DIRECT /end RECORD_LAYOUT
/begin RECORD_LAYOUT Lookup2D_X_UWORD AXIS_PTS_X 1 UWORD INDEX_INCR DIRECT /end RECORD_LAYOUT
/begin RECORD_LAYOUT Lookup2D_WORD FNC_VALUES 1 SWORD COLUMN_DIR DIRECT /end RECORD_LAYOUT
/begin RECORD_LAYOUT Lookup2D_X_WORD AXIS_PTS_X 1 SWORD INDEX_INCR DIRECT /end RECORD_LAYOUT
/begin RECORD_LAYOUT Lookup2D_ULONG FNC_VALUES 1 ULONG COLUMN_DIR DIRECT /end RECORD_LAYOUT
/begin RECORD_LAYOUT Lookup2D_X_ULONG AXIS_PTS_X 1 ULONG INDEX_INCR DIRECT /end RECORD_LAYOUT
/begin RECORD_LAYOUT Lookup2D_LONG FNC_VALUES 1 SLONG COLUMN_DIR DIRECT /end RECORD_LAYOUT
/begin RECORD_LAYOUT Lookup2D_X_LONG AXIS_PTS_X 1 SLONG INDEX_INCR DIRECT /end RECORD_LAYOUT
/begin RECORD_LAYOUT Lookup2D_FLOAT32_IEEE FNC_VALUES 1 FLOAT32_IEEE COLUMN_DIR DIRECT /end RECORD_LAYOUT
/begin RECORD_LAYOUT Lookup2D_X_FLOAT32_IEEE AXIS_PTS_X 1 FLOAT32_IEEE INDEX_INCR DIRECT /end RECORD_LAYOUT
/begin RECORD_LAYOUT Lookup2D_FLOAT64_IEEE FNC_VALUES 1 FLOAT64_IEEE COLUMN_DIR DIRECT /end RECORD_LAYOUT
/begin RECORD_LAYOUT Lookup2D_X_FLOAT64_IEEE AXIS_PTS_X 1 FLOAT64_IEEE INDEX_INCR DIRECT /end RECORD_LAYOUT
/begin MEASUREMENT Gear_Trs "" FLOAT64_IEEE VehCtrlMdel240918_2018b_CM_double 0 0 -1.7E+308 1.7E+308 ECU_ADDRESS 0x0000 /* @ECU_Address@Gear_Trs@ */ /end MEASUREMENT
/begin MEASUREMENT Mode_Trs "" FLOAT64_IEEE VehCtrlMdel240918_2018b_CM_double 0 0 -1.7E+308 1.7E+308 ECU_ADDRESS 0x0000 /* @ECU_Address@Mode_Trs@ */ /end MEASUREMENT
/begin MEASUREMENT Trq_CUT "" FLOAT64_IEEE VehCtrlMdel240918_2018b_CM_double 0 0 -1.7E+308 1.7E+308 ECU_ADDRESS 0x0000 /* @ECU_Address@Trq_CUT@ */ /end MEASUREMENT
/begin MEASUREMENT ignition "" FLOAT64_IEEE VehCtrlMdel240918_2018b_CM_double 0 0 -1.7E+308 1.7E+308 ECU_ADDRESS 0x0000 /* @ECU_Address@ignition@ */ /end MEASUREMENT
/begin MEASUREMENT L12V_error "" FLOAT64_IEEE VehCtrlMdel240918_2018b_CM_double 0 0 -1.7E+308 1.7E+308 ECU_ADDRESS 0x0000 /* @ECU_Address@L12V_error@ */ /end MEASUREMENT
/begin MEASUREMENT alarm "" FLOAT64_IEEE VehCtrlMdel240918_2018b_CM_double 0 0 -1.7E+308 1.7E+308 ECU_ADDRESS 0x0000 /* @ECU_Address@alarm@ */ /end MEASUREMENT
/begin MEASUREMENT controller_ready "" FLOAT64_IEEE VehCtrlMdel240918_2018b_CM_double 0 0 -1.7E+308 1.7E+308 ECU_ADDRESS 0x0000 /* @ECU_Address@controller_ready@ */ /end MEASUREMENT
/begin MEASUREMENT selfcheck "" FLOAT64_IEEE VehCtrlMdel240918_2018b_CM_double 0 0 -1.7E+308 1.7E+308 ECU_ADDRESS 0x0000 /* @ECU_Address@selfcheck@ */ /end MEASUREMENT
/begin MEASUREMENT RPM "" FLOAT64_IEEE VehCtrlMdel240918_2018b_CM_double 0 0 -1.7E+308 1.7E+308 ECU_ADDRESS 0x0000 /* @ECU_Address@RPM@ */ /end MEASUREMENT
/begin MEASUREMENT trq "" FLOAT64_IEEE VehCtrlMdel240918_2018b_CM_double 0 0 -1.7E+308 1.7E+308 ECU_ADDRESS 0x0000 /* @ECU_Address@trq@ */ /end MEASUREMENT
/begin MEASUREMENT AC_current "" FLOAT64_IEEE VehCtrlMdel240918_2018b_CM_double 0 0 -1.7E+308 1.7E+308 ECU_ADDRESS 0x0000 /* @ECU_Address@AC_current@ */ /end MEASUREMENT
/begin MEASUREMENT DC_current "" FLOAT64_IEEE VehCtrlMdel240918_2018b_CM_double 0 0 -1.7E+308 1.7E+308 ECU_ADDRESS 0x0000 /* @ECU_Address@DC_current@ */ /end MEASUREMENT
/begin MEASUREMENT MCU_Temp "" FLOAT64_IEEE VehCtrlMdel240918_2018b_CM_double 0 0 -1.7E+308 1.7E+308 ECU_ADDRESS 0x0000 /* @ECU_Address@MCU_Temp@ */ /end MEASUREMENT
/begin MEASUREMENT motor_Temp "" FLOAT64_IEEE VehCtrlMdel240918_2018b_CM_double 0 0 -1.7E+308 1.7E+308 ECU_ADDRESS 0x0000 /* @ECU_Address@motor_Temp@ */ /end MEASUREMENT
/begin MEASUREMENT MCFR_ActualVelocity "" FLOAT64_IEEE VehCtrlMdel240918_2018b_CM_double 0 0 -1.7E+308 1.7E+308 ECU_ADDRESS 0x0000 /* @ECU_Address@MCFR_ActualVelocity@ */ /end MEASUREMENT
/begin MEASUREMENT MCFR_DCVoltage "" FLOAT64_IEEE VehCtrlMdel240918_2018b_CM_double 0 0 -1.7E+308 1.7E+308 ECU_ADDRESS 0x0000 /* @ECU_Address@MCFR_DCVoltage@ */ /end MEASUREMENT
/begin MEASUREMENT MCFR_bDCOn "" FLOAT64_IEEE VehCtrlMdel240918_2018b_CM_double 0 0 -1.7E+308 1.7E+308 ECU_ADDRESS 0x0000 /* @ECU_Address@MCFR_bDCOn@ */ /end MEASUREMENT
/begin MEASUREMENT MCFR_bError "" FLOAT64_IEEE VehCtrlMdel240918_2018b_CM_double 0 0 -1.7E+308 1.7E+308 ECU_ADDRESS 0x0000 /* @ECU_Address@MCFR_bError@ */ /end MEASUREMENT
/begin MEASUREMENT MCFR_bInverterOn "" FLOAT64_IEEE VehCtrlMdel240918_2018b_CM_double 0 0 -1.7E+308 1.7E+308 ECU_ADDRESS 0x0000 /* @ECU_Address@MCFR_bInverterOn@ */ /end MEASUREMENT
/begin MEASUREMENT MCFR_bQuitInverterOn "" FLOAT64_IEEE VehCtrlMdel240918_2018b_CM_double 0 0 -1.7E+308 1.7E+308 ECU_ADDRESS 0x0000 /* @ECU_Address@MCFR_bQuitInverterOn@ */ /end MEASUREMENT
/begin MEASUREMENT MCFR_bSystemReady "" FLOAT64_IEEE VehCtrlMdel240918_2018b_CM_double 0 0 -1.7E+308 1.7E+308 ECU_ADDRESS 0x0000 /* @ECU_Address@MCFR_bSystemReady@ */ /end MEASUREMENT
/begin MEASUREMENT MCFR_TempIGBT "" FLOAT64_IEEE VehCtrlMdel240918_2018b_CM_double 0 0 -1.7E+308 1.7E+308 ECU_ADDRESS 0x0000 /* @ECU_Address@MCFR_TempIGBT@ */ /end MEASUREMENT
/begin MEASUREMENT MCFR_TempInverter "" FLOAT64_IEEE VehCtrlMdel240918_2018b_CM_double 0 0 -1.7E+308 1.7E+308 ECU_ADDRESS 0x0000 /* @ECU_Address@MCFR_TempInverter@ */ /end MEASUREMENT
/begin MEASUREMENT MCFR_TempMotor "" FLOAT64_IEEE VehCtrlMdel240918_2018b_CM_double 0 0 -1.7E+308 1.7E+308 ECU_ADDRESS 0x0000 /* @ECU_Address@MCFR_TempMotor@ */ /end MEASUREMENT
/begin MEASUREMENT MCFR_ErrorInfo "" FLOAT64_IEEE VehCtrlMdel240918_2018b_CM_double 0 0 -1.7E+308 1.7E+308 ECU_ADDRESS 0x0000 /* @ECU_Address@MCFR_ErrorInfo@ */ /end MEASUREMENT
/begin MEASUREMENT MCFL_ActualVelocity "" FLOAT64_IEEE VehCtrlMdel240918_2018b_CM_double 0 0 -1.7E+308 1.7E+308 ECU_ADDRESS 0x0000 /* @ECU_Address@MCFL_ActualVelocity@ */ /end MEASUREMENT
/begin MEASUREMENT MCFL_DCVoltage "" FLOAT64_IEEE VehCtrlMdel240918_2018b_CM_double 0 0 -1.7E+308 1.7E+308 ECU_ADDRESS 0x0000 /* @ECU_Address@MCFL_DCVoltage@ */ /end MEASUREMENT
/begin MEASUREMENT MCFL_bDCOn "" FLOAT64_IEEE VehCtrlMdel240918_2018b_CM_double 0 0 -1.7E+308 1.7E+308 ECU_ADDRESS 0x0000 /* @ECU_Address@MCFL_bDCOn@ */ /end MEASUREMENT
/begin MEASUREMENT MCFL_bError "" FLOAT64_IEEE VehCtrlMdel240918_2018b_CM_double 0 0 -1.7E+308 1.7E+308 ECU_ADDRESS 0x0000 /* @ECU_Address@MCFL_bError@ */ /end MEASUREMENT
/begin MEASUREMENT MCFL_bInverterOn "" FLOAT64_IEEE VehCtrlMdel240918_2018b_CM_double 0 0 -1.7E+308 1.7E+308 ECU_ADDRESS 0x0000 /* @ECU_Address@MCFL_bInverterOn@ */ /end MEASUREMENT
/begin MEASUREMENT MCFL_bQuitDCOn "" FLOAT64_IEEE VehCtrlMdel240918_2018b_CM_double 0 0 -1.7E+308 1.7E+308 ECU_ADDRESS 0x0000 /* @ECU_Address@MCFL_bQuitDCOn@ */ /end MEASUREMENT
/begin MEASUREMENT MCFL_bQuitInverterOn "" FLOAT64_IEEE VehCtrlMdel240918_2018b_CM_double 0 0 -1.7E+308 1.7E+308 ECU_ADDRESS 0x0000 /* @ECU_Address@MCFL_bQuitInverterOn@ */ /end MEASUREMENT
/begin MEASUREMENT MCFL_bSystemReady "" FLOAT64_IEEE VehCtrlMdel240918_2018b_CM_double 0 0 -1.7E+308 1.7E+308 ECU_ADDRESS 0x0000 /* @ECU_Address@MCFL_bSystemReady@ */ /end MEASUREMENT
/begin MEASUREMENT MCFL_TempIGBT "" FLOAT64_IEEE VehCtrlMdel240918_2018b_CM_double 0 0 -1.7E+308 1.7E+308 ECU_ADDRESS 0x0000 /* @ECU_Address@MCFL_TempIGBT@ */ /end MEASUREMENT
/begin MEASUREMENT MCFL_TempInverter "" FLOAT64_IEEE VehCtrlMdel240918_2018b_CM_double 0 0 -1.7E+308 1.7E+308 ECU_ADDRESS 0x0000 /* @ECU_Address@MCFL_TempInverter@ */ /end MEASUREMENT
/begin MEASUREMENT MCFL_TempMotor "" FLOAT64_IEEE VehCtrlMdel240918_2018b_CM_double 0 0 -1.7E+308 1.7E+308 ECU_ADDRESS 0x0000 /* @ECU_Address@MCFL_TempMotor@ */ /end MEASUREMENT
/begin MEASUREMENT MCFL_ErrorInfo "" FLOAT64_IEEE VehCtrlMdel240918_2018b_CM_double 0 0 -1.7E+308 1.7E+308 ECU_ADDRESS 0x0000 /* @ECU_Address@MCFL_ErrorInfo@ */ /end MEASUREMENT
/begin MEASUREMENT IMU_Ax_Value "" FLOAT64_IEEE VehCtrlMdel240918_2018b_CM_double 0 0 -1.7E+308 1.7E+308 ECU_ADDRESS 0x0000 /* @ECU_Address@IMU_Ax_Value@ */ /end MEASUREMENT
/begin MEASUREMENT Acc_vol "" ULONG VehCtrlMdel240918_2018b_CM_ufix32_En16 0 0 0 65535.999984741211 ECU_ADDRESS 0x0000 /* @ECU_Address@Acc_vol@ */ /end MEASUREMENT
/begin MEASUREMENT Acc_vol2 "" ULONG VehCtrlMdel240918_2018b_CM_ufix32_En16 0 0 0 65535.999984741211 ECU_ADDRESS 0x0000 /* @ECU_Address@Acc_vol2@ */ /end MEASUREMENT
/begin MEASUREMENT Acc_POS1 "" ULONG VehCtrlMdel240918_2018b_CM_ufix32_En16 0 0 0 65535.999984741211 ECU_ADDRESS 0x0000 /* @ECU_Address@Acc_POS1@ */ /end MEASUREMENT
/begin MEASUREMENT Acc_POS2 "" ULONG VehCtrlMdel240918_2018b_CM_ufix32_En16 0 0 0 65535.999984741211 ECU_ADDRESS 0x0000 /* @ECU_Address@Acc_POS2@ */ /end MEASUREMENT
/begin MEASUREMENT F_BrkPrs "" UWORD VehCtrlMdel240918_2018b_CM_uint16 0 0 0 65535 ECU_ADDRESS 0x0000 /* @ECU_Address@F_BrkPrs@ */ /end MEASUREMENT
/begin MEASUREMENT HVCUTOFF "" UBYTE VehCtrlMdel240918_2018b_CM_boolean 0 0 0 1 ECU_ADDRESS 0x0000 /* @ECU_Address@HVCUTOFF@ */ /end MEASUREMENT
/begin MEASUREMENT beeper_state "" UBYTE VehCtrlMdel240918_2018b_CM_boolean 0 0 0 1 ECU_ADDRESS 0x0000 /* @ECU_Address@beeper_state@ */ /end MEASUREMENT
/begin COMPU_METHOD VehCtrlMdel240918_2018b_CM_double "Q = V" RAT_FUNC "%15.10" "" COEFFS 0 1 0 0 0 1 /end COMPU_METHOD
/begin COMPU_METHOD VehCtrlMdel240918_2018b_CM_ufix32_En16 "Q = V*65536.000000" RAT_FUNC "%26.16" "" COEFFS 0 65536.000000 0.000000 0 0 1.000000 /end COMPU_METHOD
/begin COMPU_METHOD VehCtrlMdel240918_2018b_CM_uint16 "Q = V" RAT_FUNC "%5.0" "" COEFFS 0 1 0 0 0 1 /end COMPU_METHOD
/begin COMPU_METHOD VehCtrlMdel240918_2018b_CM_boolean "Q = V" RAT_FUNC "%1.0" "" COEFFS 0 1 0 0 0 1 /end COMPU_METHOD
/begin GROUP VehCtrlMdel240918_2018b "VehCtrlMdel240918_2018b" /* Root */ ROOT
 /begin SUB_GROUP Root_Drive_Ready Root_Input Root_Input_Processing Root_OUTPUT /end SUB_GROUP
/end GROUP
/begin GROUP Root_Drive_Ready "VehCtrlMdel240918_2018b/Drive_Ready" /begin SUB_GROUP S2_Subsystem /end SUB_GROUP /end GROUP
/begin GROUP Root_Input "VehCtrlMdel240918_2018b/Input"
 /begin SUB_GROUP S3_AMKMCU_Receive S3_EMRAXMCU_RECIEVE S3_IMU_Recieve S3_key /end SUB_GROUP
/end GROUP
/begin GROUP Root_Input_Processing "VehCtrlMdel240918_2018b/Input_Processing" /begin SUB_GROUP S4_Function_Call_Subsystem /end SUB_GROUP /end GROUP
/begin GROUP Root_OUTPUT "VehCtrlMdel240918_2018b/OUTPUT" /begin SUB_GROUP S5_VCU2EmraxMCU /end SUB_GROUP /end GROUP
/begin GROUP S2_Subsystem "VehCtrlMdel240918_2018b/Drive_Ready/Subsystem" /begin REF_MEASUREMENT beeper_state /end REF_MEASUREMENT /end GROUP
/begin GROUP S3_AMKMCU_Receive "VehCtrlMdel240918_2018b/Input/AMKMCU_Receive" /begin SUB_GROUP S95_FLAMKMCU S95_FRAMKMCU /end SUB_GROUP /end GROUP
/begin GROUP S3_EMRAXMCU_RECIEVE "VehCtrlMdel240918_2018b/Input/EMRAXMCU_RECIEVE" /begin SUB_GROUP S98_MCU_pwr S98_MCU_state /end SUB_GROUP /end GROUP
/begin GROUP S3_IMU_Recieve "VehCtrlMdel240918_2018b/Input/IMU_Recieve" /begin SUB_GROUP S99_IMU_state /end SUB_GROUP /end GROUP
/begin GROUP S3_key "VehCtrlMdel240918_2018b/Input/key" /begin REF_MEASUREMENT HVCUTOFF ignition /end REF_MEASUREMENT /end GROUP
/begin GROUP S4_Function_Call_Subsystem "VehCtrlMdel240918_2018b/Input_Processing/Function-Call Subsystem" /begin SUB_GROUP S165_AccBrkPedal /end SUB_GROUP /end GROUP
/begin GROUP S5_VCU2EmraxMCU "VehCtrlMdel240918_2018b/OUTPUT/VCU2EmraxMCU" /begin REF_MEASUREMENT Gear_Trs Mode_Trs /end REF_MEASUREMENT /end GROUP
/begin GROUP S95_FLAMKMCU "VehCtrlMdel240918_2018b/Input/AMKMCU_Receive/FLAMKMCU" /begin SUB_GROUP S104_AMKMCU_state S104_AMKMCU_state1 S104_AMKMCU_state2 /end SUB_GROUP /end GROUP
/begin GROUP S95_FRAMKMCU "VehCtrlMdel240918_2018b/Input/AMKMCU_Receive/FRAMKMCU" /begin SUB_GROUP S105_AMKMCU_state S105_AMKMCU_state1 S105_AMKMCU_state2 /end SUB_GROUP /end GROUP
/begin GROUP S98_MCU_pwr "VehCtrlMdel240918_2018b/Input/EMRAXMCU_RECIEVE/MCU_pwr" /begin SUB_GROUP S143_MCU_VCUMeter1 /end SUB_GROUP /end GROUP
/begin GROUP S98_MCU_state "VehCtrlMdel240918_2018b/Input/EMRAXMCU_RECIEVE/MCU_state" /begin SUB_GROUP S144_MCU_state /end SUB_GROUP /end GROUP
/begin GROUP S99_IMU_state "VehCtrlMdel240918_2018b/Input/IMU_Recieve/IMU_state" /begin SUB_GROUP S157_MCU_state /end SUB_GROUP /end GROUP
/begin GROUP S165_AccBrkPedal "VehCtrlMdel240918_2018b/Input_Processing/Function-Call Subsystem/AccBrkPedal" /begin REF_MEASUREMENT Acc_POS1 Acc_POS2 Acc_vol Acc_vol2 F_BrkPrs Trq_CUT /end REF_MEASUREMENT /end GROUP
/begin GROUP S104_AMKMCU_state "VehCtrlMdel240918_2018b/Input/AMKMCU_Receive/FLAMKMCU/AMKMCU_state" /begin SUB_GROUP S106_MCU_state /end SUB_GROUP /end GROUP
/begin GROUP S104_AMKMCU_state1 "VehCtrlMdel240918_2018b/Input/AMKMCU_Receive/FLAMKMCU/AMKMCU_state1" /begin SUB_GROUP S107_MCU_state /end SUB_GROUP /end GROUP
/begin GROUP S104_AMKMCU_state2 "VehCtrlMdel240918_2018b/Input/AMKMCU_Receive/FLAMKMCU/AMKMCU_state2" /begin SUB_GROUP S108_MCU_state /end SUB_GROUP /end GROUP
/begin GROUP S105_AMKMCU_state "VehCtrlMdel240918_2018b/Input/AMKMCU_Receive/FRAMKMCU/AMKMCU_state" /begin SUB_GROUP S124_MCU_state /end SUB_GROUP /end GROUP
/begin GROUP S105_AMKMCU_state1 "VehCtrlMdel240918_2018b/Input/AMKMCU_Receive/FRAMKMCU/AMKMCU_state1" /begin SUB_GROUP S125_MCU_state /end SUB_GROUP /end GROUP
/begin GROUP S105_AMKMCU_state2 "VehCtrlMdel240918_2018b/Input/AMKMCU_Receive/FRAMKMCU/AMKMCU_state2" /begin SUB_GROUP S126_MCU_state /end SUB_GROUP /end GROUP
/begin GROUP S143_MCU_VCUMeter1 "VehCtrlMdel240918_2018b/Input/EMRAXMCU_RECIEVE/MCU_pwr/MCU_VCUMeter1" /begin REF_MEASUREMENT AC_current DC_current MCU_Temp motor_Temp /end REF_MEASUREMENT /end GROUP
/begin GROUP S144_MCU_state "VehCtrlMdel240918_2018b/Input/EMRAXMCU_RECIEVE/MCU_state/MCU_state" /begin REF_MEASUREMENT L12V_error RPM alarm controller_ready selfcheck trq /end REF_MEASUREMENT /end GROUP
/begin GROUP S157_MCU_state "VehCtrlMdel240918_2018b/Input/IMU_Recieve/IMU_state/MCU_state" /begin REF_MEASUREMENT IMU_Ax_Value /end REF_MEASUREMENT /end GROUP
/begin GROUP S106_MCU_state "VehCtrlMdel240918_2018b/Input/AMKMCU_Receive/FLAMKMCU/AMKMCU_state/MCU_state"
 /begin REF_MEASUREMENT MCFL_ActualVelocity MCFL_DCVoltage MCFL_bDCOn MCFL_bError MCFL_bInverterOn MCFL_bQuitDCOn MCFL_bQuitInverterOn MCFL_bSystemReady /end REF_MEASUREMENT
/end GROUP
/begin GROUP S107_MCU_state "VehCtrlMdel240918_2018b/Input/AMKMCU_Receive/FLAMKMCU/AMKMCU_state1/MCU_state" /begin REF_MEASUREMENT MCFL_ErrorInfo /end REF_MEASUREMENT /end GROUP
/begin GROUP S108_MCU_state "VehCtrlMdel240918_2018b/Input/AMKMCU_Receive/FLAMKMCU/AMKMCU_state2/MCU_state" /begin REF_MEASUREMENT MCFL_TempIGBT MCFL_TempInverter MCFL_TempMotor /end REF_MEASUREMENT /end GROUP
/begin GROUP S124_MCU_state "VehCtrlMdel240918_2018b/Input/AMKMCU_Receive/FRAMKMCU/AMKMCU_state/MCU_state"
 /begin REF_MEASUREMENT MCFR_ActualVelocity MCFR_DCVoltage MCFR_bDCOn MCFR_bError MCFR_bInverterOn MCFR_bQuitInverterOn MCFR_bSystemReady /end REF_MEASUREMENT
/end GROUP
/begin GROUP S125_MCU_state "VehCtrlMdel240918_2018b/Input/AMKMCU_Receive/FRAMKMCU/AMKMCU_state1/MCU_state" /begin REF_MEASUREMENT MCFR_ErrorInfo /end REF_MEASUREMENT /end GROUP
/begin GROUP S126_MCU_state "VehCtrlMdel240918_2018b/Input/AMKMCU_Receive/FRAMKMCU/AMKMCU_state2/MCU_state" /begin REF_MEASUREMENT MCFR_TempIGBT MCFR_TempInverter MCFR_TempMotor /end REF_MEASUREMENT /end GROUP
/end MODULE
/end PROJECT
/* (add any file trailer comments here) */
/* EOF VehCtrlMdel240918_2018b.a2l */
