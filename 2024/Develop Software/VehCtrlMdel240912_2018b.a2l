/******************************************************************************
* ASAP2 file: VehCtrlMdel240912_2018b.a2l
* Code generation for model "VehCtrlMdel240912_2018b".
* Model version : 1.123
* Simulink Coder version : 9.2 (R2019b) 18-Jul-2019
* C source code generated on : Sat Sep 14 22:03:01 2024
* Target selection: ec5744.tlc
* Embedded hardware selection: Freescale MPC5500
* Code generation objectives: Unspecified
* Validation result: Not run
* (add additional file header information here)
******************************************************************************/ ASAP2_VERSION 1 31
/* Version 1.31 */
/begin PROJECT ECUCoderProject "ECUCoder Project"
/begin HEADER "Header Comments go here" /end HEADER
/begin MODULE ModuleName "Module Comment Goes Here"
/begin MOD_PAR "MOD PAR Comment Goes Here" /end MOD_PAR
/begin MOD_COMMON "Mod Common Comment Here" BYTE_ORDER MSB_FIRST /end MOD_COMMON
/begin RECORD_LAYOUT Scalar_BOOLEAN FNC_VALUES 1 UBYTE COLUMN_DIR DIRECT /end RECORD_LAYOUT
/begin RECORD_LAYOUT Scalar_UBYTE FNC_VALUES 1 UBYTE COLUMN_DIR DIRECT /end RECORD_LAYOUT
/begin RECORD_LAYOUT Scalar_BYTE FNC_VALUES 1 SBYTE COLUMN_DIR DIRECT /end RECORD_LAYOUT
/begin RECORD_LAYOUT Scalar_UWORD FNC_VALUES 1 UWORD COLUMN_DIR DIRECT /end RECORD_LAYOUT
/begin RECORD_LAYOUT Scalar_SWORD FNC_VALUES 1 SWORD COLUMN_DIR DIRECT /end RECORD_LAYOUT
/begin RECORD_LAYOUT Scalar_ULONG FNC_VALUES 1 ULONG COLUMN_DIR DIRECT /end RECORD_LAYOUT
/begin RECORD_LAYOUT Scalar_LONG FNC_VALUES 1 SLONG COLUMN_DIR DIRECT /end RECORD_LAYOUT
/begin RECORD_LAYOUT Scalar_FLOAT32_IEEE FNC_VALUES 1 FLOAT32_IEEE COLUMN_DIR DIRECT /end RECORD_LAYOUT
/begin RECORD_LAYOUT Scalar_FLOAT64_IEEE FNC_VALUES 1 FLOAT64_IEEE COLUMN_DIR DIRECT /end RECORD_LAYOUT
/begin RECORD_LAYOUT Lookup1D_BOOLEAN FNC_VALUES 1 UBYTE COLUMN_DIR DIRECT /end RECORD_LAYOUT
/begin RECORD_LAYOUT Lookup1D_X_BOOLEAN AXIS_PTS_X 1 UBYTE INDEX_INCR DIRECT /end RECORD_LAYOUT
/begin RECORD_LAYOUT Lookup1D_BYTE FNC_VALUES 1 SBYTE COLUMN_DIR DIRECT /end RECORD_LAYOUT
/begin RECORD_LAYOUT Lookup1D_X_BYTE AXIS_PTS_X 1 SBYTE INDEX_INCR DIRECT /end RECORD_LAYOUT
/begin RECORD_LAYOUT Lookup1D_UBYTE FNC_VALUES 1 UBYTE COLUMN_DIR DIRECT /end RECORD_LAYOUT
/begin RECORD_LAYOUT Lookup1D_X_UBYTE AXIS_PTS_X 1 UBYTE INDEX_INCR DIRECT /end RECORD_LAYOUT
/begin RECORD_LAYOUT Lookup1D_UWORD FNC_VALUES 1 UWORD COLUMN_DIR DIRECT /end RECORD_LAYOUT
/begin RECORD_LAYOUT Lookup1D_X_UWORD AXIS_PTS_X 1 UWORD INDEX_INCR DIRECT /end RECORD_LAYOUT
/begin RECORD_LAYOUT Lookup1D_WORD FNC_VALUES 1 SWORD COLUMN_DIR DIRECT /end RECORD_LAYOUT
/begin RECORD_LAYOUT Lookup1D_X_WORD AXIS_PTS_X 1 SWORD INDEX_INCR DIRECT /end RECORD_LAYOUT
/begin RECORD_LAYOUT Lookup1D_ULONG FNC_VALUES 1 ULONG COLUMN_DIR DIRECT /end RECORD_LAYOUT
/begin RECORD_LAYOUT Lookup1D_X_ULONG AXIS_PTS_X 1 ULONG INDEX_INCR DIRECT /end RECORD_LAYOUT
/begin RECORD_LAYOUT Lookup1D_SLONG FNC_VALUES 1 SLONG COLUMN_DIR DIRECT /end RECORD_LAYOUT
/begin RECORD_LAYOUT Lookup1D_X_LONG AXIS_PTS_X 1 SLONG INDEX_INCR DIRECT /end RECORD_LAYOUT
/begin RECORD_LAYOUT Lookup1D_FLOAT32_IEEE FNC_VALUES 1 FLOAT32_IEEE COLUMN_DIR DIRECT /end RECORD_LAYOUT
/begin RECORD_LAYOUT Lookup1D_X_FLOAT32_IEEE AXIS_PTS_X 1 FLOAT32_IEEE INDEX_INCR DIRECT /end RECORD_LAYOUT
/begin RECORD_LAYOUT Lookup1D_FLOAT64_IEEE FNC_VALUES 1 FLOAT64_IEEE COLUMN_DIR DIRECT /end RECORD_LAYOUT
/begin RECORD_LAYOUT Lookup1D_X_FLOAT64_IEEE AXIS_PTS_X 1 FLOAT64_IEEE INDEX_INCR DIRECT /end RECORD_LAYOUT
/begin RECORD_LAYOUT Lookup2D_BOOLEAN FNC_VALUES 1 UBYTE COLUMN_DIR DIRECT /end RECORD_LAYOUT
/begin RECORD_LAYOUT Lookup2D_X_BOOLEAN AXIS_PTS_X 1 UBYTE INDEX_INCR DIRECT /end RECORD_LAYOUT
/begin RECORD_LAYOUT Lookup2D_UBYTE FNC_VALUES 1 UBYTE COLUMN_DIR DIRECT /end RECORD_LAYOUT
/begin RECORD_LAYOUT Lookup2D_X_UBYTE AXIS_PTS_X 1 UBYTE INDEX_INCR DIRECT /end RECORD_LAYOUT
/begin RECORD_LAYOUT Lookup2D_BYTE FNC_VALUES 1 SBYTE COLUMN_DIR DIRECT /end RECORD_LAYOUT
/begin RECORD_LAYOUT Lookup2D_X_BYTE AXIS_PTS_X 1 SBYTE INDEX_INCR DIRECT /end RECORD_LAYOUT
/begin RECORD_LAYOUT Lookup2D_UWORD FNC_VALUES 1 UWORD COLUMN_DIR DIRECT /end RECORD_LAYOUT
/begin RECORD_LAYOUT Lookup2D_X_UWORD AXIS_PTS_X 1 UWORD INDEX_INCR DIRECT /end RECORD_LAYOUT
/begin RECORD_LAYOUT Lookup2D_WORD FNC_VALUES 1 SWORD COLUMN_DIR DIRECT /end RECORD_LAYOUT
/begin RECORD_LAYOUT Lookup2D_X_WORD AXIS_PTS_X 1 SWORD INDEX_INCR DIRECT /end RECORD_LAYOUT
/begin RECORD_LAYOUT Lookup2D_ULONG FNC_VALUES 1 ULONG COLUMN_DIR DIRECT /end RECORD_LAYOUT
/begin RECORD_LAYOUT Lookup2D_X_ULONG AXIS_PTS_X 1 ULONG INDEX_INCR DIRECT /end RECORD_LAYOUT
/begin RECORD_LAYOUT Lookup2D_LONG FNC_VALUES 1 SLONG COLUMN_DIR DIRECT /end RECORD_LAYOUT
/begin RECORD_LAYOUT Lookup2D_X_LONG AXIS_PTS_X 1 SLONG INDEX_INCR DIRECT /end RECORD_LAYOUT
/begin RECORD_LAYOUT Lookup2D_FLOAT32_IEEE FNC_VALUES 1 FLOAT32_IEEE COLUMN_DIR DIRECT /end RECORD_LAYOUT
/begin RECORD_LAYOUT Lookup2D_X_FLOAT32_IEEE AXIS_PTS_X 1 FLOAT32_IEEE INDEX_INCR DIRECT /end RECORD_LAYOUT
/begin RECORD_LAYOUT Lookup2D_FLOAT64_IEEE FNC_VALUES 1 FLOAT64_IEEE COLUMN_DIR DIRECT /end RECORD_LAYOUT
/begin RECORD_LAYOUT Lookup2D_X_FLOAT64_IEEE AXIS_PTS_X 1 FLOAT64_IEEE INDEX_INCR DIRECT /end RECORD_LAYOUT
/begin MEASUREMENT VehCtrlMdel240912_2018b_B.AMKCLDCON_e "" UBYTE VehCtrlMdel240912_2018b_CM_boolean 0 0 0 1 ECU_ADDRESS 0x0000 /* @ECU_Address@VehCtrlMdel240912_2018b_B.AMKCLDCON_e@ */ /end MEASUREMENT
/begin MEASUREMENT VehCtrlMdel240912_2018b_B.HVCUTOFF_j "" UBYTE VehCtrlMdel240912_2018b_CM_boolean 0 0 0 1 ECU_ADDRESS 0x0000 /* @ECU_Address@VehCtrlMdel240912_2018b_B.HVCUTOFF_j@ */ /end MEASUREMENT
/begin MEASUREMENT Gear_Trs "" FLOAT64_IEEE VehCtrlMdel240912_2018b_CM_double 0 0 -1.7E+308 1.7E+308 ECU_ADDRESS 0x0000 /* @ECU_Address@Gear_Trs@ */ /end MEASUREMENT
/begin MEASUREMENT Mode_Trs "" FLOAT64_IEEE VehCtrlMdel240912_2018b_CM_double 0 0 -1.7E+308 1.7E+308 ECU_ADDRESS 0x0000 /* @ECU_Address@Mode_Trs@ */ /end MEASUREMENT
/begin MEASUREMENT Trq_CUT "" FLOAT64_IEEE VehCtrlMdel240912_2018b_CM_double 0 0 -1.7E+308 1.7E+308 ECU_ADDRESS 0x0000 /* @ECU_Address@Trq_CUT@ */ /end MEASUREMENT
/begin MEASUREMENT L12V_error "" FLOAT64_IEEE VehCtrlMdel240912_2018b_CM_double 0 0 -1.7E+308 1.7E+308 ECU_ADDRESS 0x0000 /* @ECU_Address@L12V_error@ */ /end MEASUREMENT
/begin MEASUREMENT alarm "" FLOAT64_IEEE VehCtrlMdel240912_2018b_CM_double 0 0 -1.7E+308 1.7E+308 ECU_ADDRESS 0x0000 /* @ECU_Address@alarm@ */ /end MEASUREMENT
/begin MEASUREMENT controller_ready "" FLOAT64_IEEE VehCtrlMdel240912_2018b_CM_double 0 0 -1.7E+308 1.7E+308 ECU_ADDRESS 0x0000 /* @ECU_Address@controller_ready@ */ /end MEASUREMENT
/begin MEASUREMENT selfcheck "" FLOAT64_IEEE VehCtrlMdel240912_2018b_CM_double 0 0 -1.7E+308 1.7E+308 ECU_ADDRESS 0x0000 /* @ECU_Address@selfcheck@ */ /end MEASUREMENT
/begin MEASUREMENT RPM "" FLOAT64_IEEE VehCtrlMdel240912_2018b_CM_double 0 0 -1.7E+308 1.7E+308 ECU_ADDRESS 0x0000 /* @ECU_Address@RPM@ */ /end MEASUREMENT
/begin MEASUREMENT trq "" FLOAT64_IEEE VehCtrlMdel240912_2018b_CM_double 0 0 -1.7E+308 1.7E+308 ECU_ADDRESS 0x0000 /* @ECU_Address@trq@ */ /end MEASUREMENT
/begin MEASUREMENT AC_current "" FLOAT64_IEEE VehCtrlMdel240912_2018b_CM_double 0 0 -1.7E+308 1.7E+308 ECU_ADDRESS 0x0000 /* @ECU_Address@AC_current@ */ /end MEASUREMENT
/begin MEASUREMENT DC_current "" FLOAT64_IEEE VehCtrlMdel240912_2018b_CM_double 0 0 -1.7E+308 1.7E+308 ECU_ADDRESS 0x0000 /* @ECU_Address@DC_current@ */ /end MEASUREMENT
/begin MEASUREMENT MCU_Temp "" FLOAT64_IEEE VehCtrlMdel240912_2018b_CM_double 0 0 -1.7E+308 1.7E+308 ECU_ADDRESS 0x0000 /* @ECU_Address@MCU_Temp@ */ /end MEASUREMENT
/begin MEASUREMENT motor_Temp "" FLOAT64_IEEE VehCtrlMdel240912_2018b_CM_double 0 0 -1.7E+308 1.7E+308 ECU_ADDRESS 0x0000 /* @ECU_Address@motor_Temp@ */ /end MEASUREMENT
/begin MEASUREMENT StrWhlAngAliveRollCnt "" FLOAT64_IEEE VehCtrlMdel240912_2018b_CM_double 0 0 -1.7E+308 1.7E+308 ECU_ADDRESS 0x0000 /* @ECU_Address@StrWhlAngAliveRollCnt@ */ /end MEASUREMENT
/begin MEASUREMENT StrWhlAng "" FLOAT64_IEEE VehCtrlMdel240912_2018b_CM_double 0 0 -1.7E+308 1.7E+308 ECU_ADDRESS 0x0000 /* @ECU_Address@StrWhlAng@ */ /end MEASUREMENT
/begin MEASUREMENT StrWhlAngV "" FLOAT64_IEEE VehCtrlMdel240912_2018b_CM_double 0 0 -1.7E+308 1.7E+308 ECU_ADDRESS 0x0000 /* @ECU_Address@StrWhlAngV@ */ /end MEASUREMENT
/begin MEASUREMENT IMU_Ax_Valid "" FLOAT64_IEEE VehCtrlMdel240912_2018b_CM_double 0 0 -1.7E+308 1.7E+308 ECU_ADDRESS 0x0000 /* @ECU_Address@IMU_Ax_Valid@ */ /end MEASUREMENT
/begin MEASUREMENT IMU_Ax_Value "" FLOAT64_IEEE VehCtrlMdel240912_2018b_CM_double 0 0 -1.7E+308 1.7E+308 ECU_ADDRESS 0x0000 /* @ECU_Address@IMU_Ax_Value@ */ /end MEASUREMENT
/begin MEASUREMENT IMU_Ay_Valid "" FLOAT64_IEEE VehCtrlMdel240912_2018b_CM_double 0 0 -1.7E+308 1.7E+308 ECU_ADDRESS 0x0000 /* @ECU_Address@IMU_Ay_Valid@ */ /end MEASUREMENT
/begin MEASUREMENT IMU_Ay_Value "" FLOAT64_IEEE VehCtrlMdel240912_2018b_CM_double 0 0 -1.7E+308 1.7E+308 ECU_ADDRESS 0x0000 /* @ECU_Address@IMU_Ay_Value@ */ /end MEASUREMENT
/begin MEASUREMENT IMU_DTC "" FLOAT64_IEEE VehCtrlMdel240912_2018b_CM_double 0 0 -1.7E+308 1.7E+308 ECU_ADDRESS 0x0000 /* @ECU_Address@IMU_DTC@ */ /end MEASUREMENT
/begin MEASUREMENT IMU_Yaw_Valid "" FLOAT64_IEEE VehCtrlMdel240912_2018b_CM_double 0 0 -1.7E+308 1.7E+308 ECU_ADDRESS 0x0000 /* @ECU_Address@IMU_Yaw_Valid@ */ /end MEASUREMENT
/begin MEASUREMENT IMU_Yaw_Value "" FLOAT64_IEEE VehCtrlMdel240912_2018b_CM_double 0 0 -1.7E+308 1.7E+308 ECU_ADDRESS 0x0000 /* @ECU_Address@IMU_Yaw_Value@ */ /end MEASUREMENT
/begin MEASUREMENT Acc_vol "" ULONG VehCtrlMdel240912_2018b_CM_ufix32_En16 0 0 0 65535.999984741211 ECU_ADDRESS 0x0000 /* @ECU_Address@Acc_vol@ */ /end MEASUREMENT
/begin MEASUREMENT Acc_vol2 "" ULONG VehCtrlMdel240912_2018b_CM_ufix32_En16 0 0 0 65535.999984741211 ECU_ADDRESS 0x0000 /* @ECU_Address@Acc_vol2@ */ /end MEASUREMENT
/begin MEASUREMENT Acc_POS1 "" ULONG VehCtrlMdel240912_2018b_CM_ufix32_En16 0 0 0 65535.999984741211 ECU_ADDRESS 0x0000 /* @ECU_Address@Acc_POS1@ */ /end MEASUREMENT
/begin MEASUREMENT Acc_POS2 "" ULONG VehCtrlMdel240912_2018b_CM_ufix32_En16 0 0 0 65535.999984741211 ECU_ADDRESS 0x0000 /* @ECU_Address@Acc_POS2@ */ /end MEASUREMENT
/begin MEASUREMENT F_BrkPrs "" UWORD VehCtrlMdel240912_2018b_CM_uint16 0 0 0 65535 ECU_ADDRESS 0x0000 /* @ECU_Address@F_BrkPrs@ */ /end MEASUREMENT
/begin MEASUREMENT ignition "" UBYTE VehCtrlMdel240912_2018b_CM_boolean 0 0 0 1 ECU_ADDRESS 0x0000 /* @ECU_Address@ignition@ */ /end MEASUREMENT
/begin MEASUREMENT beeper_state "" UBYTE VehCtrlMdel240912_2018b_CM_boolean 0 0 0 1 ECU_ADDRESS 0x0000 /* @ECU_Address@beeper_state@ */ /end MEASUREMENT
/begin COMPU_METHOD VehCtrlMdel240912_2018b_CM_boolean "Q = V" RAT_FUNC "%1.0" "" COEFFS 0 1 0 0 0 1 /end COMPU_METHOD
/begin COMPU_METHOD VehCtrlMdel240912_2018b_CM_double "Q = V" RAT_FUNC "%15.10" "" COEFFS 0 1 0 0 0 1 /end COMPU_METHOD
/begin COMPU_METHOD VehCtrlMdel240912_2018b_CM_ufix32_En16 "Q = V*65536.000000" RAT_FUNC "%26.16" "" COEFFS 0 65536.000000 0.000000 0 0 1.000000 /end COMPU_METHOD
/begin COMPU_METHOD VehCtrlMdel240912_2018b_CM_uint16 "Q = V" RAT_FUNC "%5.0" "" COEFFS 0 1 0 0 0 1 /end COMPU_METHOD
/begin GROUP VehCtrlMdel240912_2018b "VehCtrlMdel240912_2018b" /* Root */ ROOT
 /begin SUB_GROUP Root_Drive_Ready Root_Input Root_Input_Processing Root_OUTPUT /end SUB_GROUP
/end GROUP
/begin GROUP Root_Drive_Ready "VehCtrlMdel240912_2018b/Drive_Ready" /begin SUB_GROUP S2_Subsystem /end SUB_GROUP /end GROUP
/begin GROUP Root_Input "VehCtrlMdel240912_2018b/Input"
 /begin SUB_GROUP S3_EMRAXMCU_RECIEVE S3_IMU_Recieve S3_StrSnis_Receive S3_key /end SUB_GROUP
/end GROUP
/begin GROUP Root_Input_Processing "VehCtrlMdel240912_2018b/Input_Processing" /begin SUB_GROUP S4_Function_Call_Subsystem /end SUB_GROUP /end GROUP
/begin GROUP Root_OUTPUT "VehCtrlMdel240912_2018b/OUTPUT" /begin SUB_GROUP S5_VCU2EmraxMCU /end SUB_GROUP /end GROUP
/begin GROUP S2_Subsystem "VehCtrlMdel240912_2018b/Drive_Ready/Subsystem" /begin REF_MEASUREMENT beeper_state /end REF_MEASUREMENT /end GROUP
/begin GROUP S3_EMRAXMCU_RECIEVE "VehCtrlMdel240912_2018b/Input/EMRAXMCU_RECIEVE" /begin SUB_GROUP S98_MCU_pwr S98_MCU_state /end SUB_GROUP /end GROUP
/begin GROUP S3_IMU_Recieve "VehCtrlMdel240912_2018b/Input/IMU_Recieve" /begin SUB_GROUP S99_IMU_state /end SUB_GROUP /end GROUP
/begin GROUP S3_StrSnis_Receive "VehCtrlMdel240912_2018b/Input/StrSnis_Receive" /begin SUB_GROUP S100_StrWhSnis_state /end SUB_GROUP /end GROUP
/begin GROUP S3_key "VehCtrlMdel240912_2018b/Input/key"
 /begin REF_MEASUREMENT VehCtrlMdel240912_2018b_B.AMKCLDCON_e VehCtrlMdel240912_2018b_B.HVCUTOFF_j ignition /end REF_MEASUREMENT
/end GROUP
/begin GROUP S4_Function_Call_Subsystem "VehCtrlMdel240912_2018b/Input_Processing/Function-Call Subsystem" /begin SUB_GROUP S149_AccBrkPedal /end SUB_GROUP /end GROUP
/begin GROUP S5_VCU2EmraxMCU "VehCtrlMdel240912_2018b/OUTPUT/VCU2EmraxMCU" /begin REF_MEASUREMENT Gear_Trs Mode_Trs /end REF_MEASUREMENT /end GROUP
/begin GROUP S98_MCU_pwr "VehCtrlMdel240912_2018b/Input/EMRAXMCU_RECIEVE/MCU_pwr" /begin SUB_GROUP S120_MCU_VCUMeter1 /end SUB_GROUP /end GROUP
/begin GROUP S98_MCU_state "VehCtrlMdel240912_2018b/Input/EMRAXMCU_RECIEVE/MCU_state" /begin SUB_GROUP S121_MCU_state /end SUB_GROUP /end GROUP
/begin GROUP S99_IMU_state "VehCtrlMdel240912_2018b/Input/IMU_Recieve/IMU_state" /begin SUB_GROUP S134_MCU_state /end SUB_GROUP /end GROUP
/begin GROUP S100_StrWhSnis_state "VehCtrlMdel240912_2018b/Input/StrSnis_Receive/StrWhSnis_state" /begin SUB_GROUP S143_IMU_state /end SUB_GROUP /end GROUP
/begin GROUP S149_AccBrkPedal "VehCtrlMdel240912_2018b/Input_Processing/Function-Call Subsystem/AccBrkPedal" /begin REF_MEASUREMENT Acc_POS1 Acc_POS2 Acc_vol Acc_vol2 F_BrkPrs Trq_CUT /end REF_MEASUREMENT /end GROUP
/begin GROUP S120_MCU_VCUMeter1 "VehCtrlMdel240912_2018b/Input/EMRAXMCU_RECIEVE/MCU_pwr/MCU_VCUMeter1" /begin REF_MEASUREMENT AC_current DC_current MCU_Temp motor_Temp /end REF_MEASUREMENT /end GROUP
/begin GROUP S121_MCU_state "VehCtrlMdel240912_2018b/Input/EMRAXMCU_RECIEVE/MCU_state/MCU_state" /begin REF_MEASUREMENT L12V_error RPM alarm controller_ready selfcheck trq /end REF_MEASUREMENT /end GROUP
/begin GROUP S134_MCU_state "VehCtrlMdel240912_2018b/Input/IMU_Recieve/IMU_state/MCU_state"
 /begin REF_MEASUREMENT IMU_Ax_Valid IMU_Ax_Value IMU_Ay_Valid IMU_Ay_Value IMU_DTC IMU_Yaw_Valid IMU_Yaw_Value /end REF_MEASUREMENT
/end GROUP
/begin GROUP S143_IMU_state "VehCtrlMdel240912_2018b/Input/StrSnis_Receive/StrWhSnis_state/IMU_state" /begin REF_MEASUREMENT StrWhlAng StrWhlAngAliveRollCnt StrWhlAngV /end REF_MEASUREMENT /end GROUP
/end MODULE
/end PROJECT
/* (add any file trailer comments here) */
/* EOF VehCtrlMdel240912_2018b.a2l */
