/******************************************************************************
* ASAP2 file: VehCtrlMdel241025_2018b_amkspdlimit.a2l
* Code generation for model "VehCtrlMdel241025_2018b_amkspdlimit".
* Model version : 1.305
* Simulink Coder version : 9.2 (R2019b) 18-Jul-2019
* C source code generated on : Fri Oct 25 15:32:33 2024
* Target selection: ec5744.tlc
* Embedded hardware selection: Freescale MPC5500
* Code generation objectives: Unspecified
* Validation result: Not run
* (add additional file header information here)
******************************************************************************/ ASAP2_VERSION 1 31
/* Version 1.31 */
/begin PROJECT ECUCoderProject "ECUCoder Project"
/begin HEADER "Header Comments go here" /end HEADER
/begin MODULE ModuleName "Module Comment Goes Here"
/begin MOD_PAR "MOD PAR Comment Goes Here" /end MOD_PAR
/begin MOD_COMMON "Mod Common Comment Here" BYTE_ORDER MSB_FIRST /end MOD_COMMON
/begin RECORD_LAYOUT Scalar_BOOLEAN FNC_VALUES 1 UBYTE COLUMN_DIR DIRECT /end RECORD_LAYOUT
/begin RECORD_LAYOUT Scalar_UBYTE FNC_VALUES 1 UBYTE COLUMN_DIR DIRECT /end RECORD_LAYOUT
/begin RECORD_LAYOUT Scalar_BYTE FNC_VALUES 1 SBYTE COLUMN_DIR DIRECT /end RECORD_LAYOUT
/begin RECORD_LAYOUT Scalar_UWORD FNC_VALUES 1 UWORD COLUMN_DIR DIRECT /end RECORD_LAYOUT
/begin RECORD_LAYOUT Scalar_SWORD FNC_VALUES 1 SWORD COLUMN_DIR DIRECT /end RECORD_LAYOUT
/begin RECORD_LAYOUT Scalar_ULONG FNC_VALUES 1 ULONG COLUMN_DIR DIRECT /end RECORD_LAYOUT
/begin RECORD_LAYOUT Scalar_LONG FNC_VALUES 1 SLONG COLUMN_DIR DIRECT /end RECORD_LAYOUT
/begin RECORD_LAYOUT Scalar_FLOAT32_IEEE FNC_VALUES 1 FLOAT32_IEEE COLUMN_DIR DIRECT /end RECORD_LAYOUT
/begin RECORD_LAYOUT Scalar_FLOAT64_IEEE FNC_VALUES 1 FLOAT64_IEEE COLUMN_DIR DIRECT /end RECORD_LAYOUT
/begin RECORD_LAYOUT Lookup1D_BOOLEAN FNC_VALUES 1 UBYTE COLUMN_DIR DIRECT /end RECORD_LAYOUT
/begin RECORD_LAYOUT Lookup1D_X_BOOLEAN AXIS_PTS_X 1 UBYTE INDEX_INCR DIRECT /end RECORD_LAYOUT
/begin RECORD_LAYOUT Lookup1D_BYTE FNC_VALUES 1 SBYTE COLUMN_DIR DIRECT /end RECORD_LAYOUT
/begin RECORD_LAYOUT Lookup1D_X_BYTE AXIS_PTS_X 1 SBYTE INDEX_INCR DIRECT /end RECORD_LAYOUT
/begin RECORD_LAYOUT Lookup1D_UBYTE FNC_VALUES 1 UBYTE COLUMN_DIR DIRECT /end RECORD_LAYOUT
/begin RECORD_LAYOUT Lookup1D_X_UBYTE AXIS_PTS_X 1 UBYTE INDEX_INCR DIRECT /end RECORD_LAYOUT
/begin RECORD_LAYOUT Lookup1D_UWORD FNC_VALUES 1 UWORD COLUMN_DIR DIRECT /end RECORD_LAYOUT
/begin RECORD_LAYOUT Lookup1D_X_UWORD AXIS_PTS_X 1 UWORD INDEX_INCR DIRECT /end RECORD_LAYOUT
/begin RECORD_LAYOUT Lookup1D_WORD FNC_VALUES 1 SWORD COLUMN_DIR DIRECT /end RECORD_LAYOUT
/begin RECORD_LAYOUT Lookup1D_X_WORD AXIS_PTS_X 1 SWORD INDEX_INCR DIRECT /end RECORD_LAYOUT
/begin RECORD_LAYOUT Lookup1D_ULONG FNC_VALUES 1 ULONG COLUMN_DIR DIRECT /end RECORD_LAYOUT
/begin RECORD_LAYOUT Lookup1D_X_ULONG AXIS_PTS_X 1 ULONG INDEX_INCR DIRECT /end RECORD_LAYOUT
/begin RECORD_LAYOUT Lookup1D_SLONG FNC_VALUES 1 SLONG COLUMN_DIR DIRECT /end RECORD_LAYOUT
/begin RECORD_LAYOUT Lookup1D_X_LONG AXIS_PTS_X 1 SLONG INDEX_INCR DIRECT /end RECORD_LAYOUT
/begin RECORD_LAYOUT Lookup1D_FLOAT32_IEEE FNC_VALUES 1 FLOAT32_IEEE COLUMN_DIR DIRECT /end RECORD_LAYOUT
/begin RECORD_LAYOUT Lookup1D_X_FLOAT32_IEEE AXIS_PTS_X 1 FLOAT32_IEEE INDEX_INCR DIRECT /end RECORD_LAYOUT
/begin RECORD_LAYOUT Lookup1D_FLOAT64_IEEE FNC_VALUES 1 FLOAT64_IEEE COLUMN_DIR DIRECT /end RECORD_LAYOUT
/begin RECORD_LAYOUT Lookup1D_X_FLOAT64_IEEE AXIS_PTS_X 1 FLOAT64_IEEE INDEX_INCR DIRECT /end RECORD_LAYOUT
/begin RECORD_LAYOUT Lookup2D_BOOLEAN FNC_VALUES 1 UBYTE COLUMN_DIR DIRECT /end RECORD_LAYOUT
/begin RECORD_LAYOUT Lookup2D_X_BOOLEAN AXIS_PTS_X 1 UBYTE INDEX_INCR DIRECT /end RECORD_LAYOUT
/begin RECORD_LAYOUT Lookup2D_UBYTE FNC_VALUES 1 UBYTE COLUMN_DIR DIRECT /end RECORD_LAYOUT
/begin RECORD_LAYOUT Lookup2D_X_UBYTE AXIS_PTS_X 1 UBYTE INDEX_INCR DIRECT /end RECORD_LAYOUT
/begin RECORD_LAYOUT Lookup2D_BYTE FNC_VALUES 1 SBYTE COLUMN_DIR DIRECT /end RECORD_LAYOUT
/begin RECORD_LAYOUT Lookup2D_X_BYTE AXIS_PTS_X 1 SBYTE INDEX_INCR DIRECT /end RECORD_LAYOUT
/begin RECORD_LAYOUT Lookup2D_UWORD FNC_VALUES 1 UWORD COLUMN_DIR DIRECT /end RECORD_LAYOUT
/begin RECORD_LAYOUT Lookup2D_X_UWORD AXIS_PTS_X 1 UWORD INDEX_INCR DIRECT /end RECORD_LAYOUT
/begin RECORD_LAYOUT Lookup2D_WORD FNC_VALUES 1 SWORD COLUMN_DIR DIRECT /end RECORD_LAYOUT
/begin RECORD_LAYOUT Lookup2D_X_WORD AXIS_PTS_X 1 SWORD INDEX_INCR DIRECT /end RECORD_LAYOUT
/begin RECORD_LAYOUT Lookup2D_ULONG FNC_VALUES 1 ULONG COLUMN_DIR DIRECT /end RECORD_LAYOUT
/begin RECORD_LAYOUT Lookup2D_X_ULONG AXIS_PTS_X 1 ULONG INDEX_INCR DIRECT /end RECORD_LAYOUT
/begin RECORD_LAYOUT Lookup2D_LONG FNC_VALUES 1 SLONG COLUMN_DIR DIRECT /end RECORD_LAYOUT
/begin RECORD_LAYOUT Lookup2D_X_LONG AXIS_PTS_X 1 SLONG INDEX_INCR DIRECT /end RECORD_LAYOUT
/begin RECORD_LAYOUT Lookup2D_FLOAT32_IEEE FNC_VALUES 1 FLOAT32_IEEE COLUMN_DIR DIRECT /end RECORD_LAYOUT
/begin RECORD_LAYOUT Lookup2D_X_FLOAT32_IEEE AXIS_PTS_X 1 FLOAT32_IEEE INDEX_INCR DIRECT /end RECORD_LAYOUT
/begin RECORD_LAYOUT Lookup2D_FLOAT64_IEEE FNC_VALUES 1 FLOAT64_IEEE COLUMN_DIR DIRECT /end RECORD_LAYOUT
/begin RECORD_LAYOUT Lookup2D_X_FLOAT64_IEEE AXIS_PTS_X 1 FLOAT64_IEEE INDEX_INCR DIRECT /end RECORD_LAYOUT
/begin MEASUREMENT VehCtrlMdel241025_2018b_amksp_B.ModeSW_o "" FLOAT64_IEEE VehCtrlMdel241025_2018b_amkspdlimit_CM_double 0 0 -1.7E+308 1.7E+308 ECU_ADDRESS @MemoryAddress@VehCtrlMdel241025_2018b_amksp_B.ModeSW_o@ /end MEASUREMENT
/begin MEASUREMENT VehCtrlMdel241025_2018b_amksp_B.AMKSWITCH_bx "" FLOAT64_IEEE VehCtrlMdel241025_2018b_amkspdlimit_CM_double 0 0 -1.7E+308 1.7E+308 ECU_ADDRESS @MemoryAddress@VehCtrlMdel241025_2018b_amksp_B.AMKSWITCH_bx@ /end MEASUREMENT
/begin MEASUREMENT VehCtrlMdel241025_2018b_amksp_B.ignition_d "" FLOAT64_IEEE VehCtrlMdel241025_2018b_amkspdlimit_CM_double 0 0 -1.7E+308 1.7E+308 ECU_ADDRESS @MemoryAddress@VehCtrlMdel241025_2018b_amksp_B.ignition_d@ /end MEASUREMENT
/begin MEASUREMENT VehCtrlMdel241025_2018b_amksp_B.TSAL_SW_IN_i2 "" UBYTE VehCtrlMdel241025_2018b_amkspdlimit_CM_boolean 0 0 0 1 ECU_ADDRESS @MemoryAddress@VehCtrlMdel241025_2018b_amksp_B.TSAL_SW_IN_i2@ /end MEASUREMENT
/begin MEASUREMENT VehCtrlMdel241025_2018b_amksp_B.out2_h "" UBYTE VehCtrlMdel241025_2018b_amkspdlimit_CM_boolean 0 0 0 1 ECU_ADDRESS @MemoryAddress@VehCtrlMdel241025_2018b_amksp_B.out2_h@ /end MEASUREMENT
/begin MEASUREMENT VehCtrlMdel241025_2018b_amksp_B.HV_voltValid_kx "" UBYTE VehCtrlMdel241025_2018b_amkspdlimit_CM_boolean 0 0 0 1 ECU_ADDRESS @MemoryAddress@VehCtrlMdel241025_2018b_amksp_B.HV_voltValid_kx@ /end MEASUREMENT
/begin MEASUREMENT Gear_Trs "" FLOAT64_IEEE VehCtrlMdel241025_2018b_amkspdlimit_CM_double 0 0 -1.7E+308 1.7E+308 ECU_ADDRESS @MemoryAddress@Gear_Trs@ /end MEASUREMENT
/begin MEASUREMENT Mode_Trs "" FLOAT64_IEEE VehCtrlMdel241025_2018b_amkspdlimit_CM_double 0 0 -1.7E+308 1.7E+308 ECU_ADDRESS @MemoryAddress@Mode_Trs@ /end MEASUREMENT
/begin MEASUREMENT KeyPressed "" FLOAT64_IEEE VehCtrlMdel241025_2018b_amkspdlimit_CM_double 0 0 -1.7E+308 1.7E+308 ECU_ADDRESS @MemoryAddress@KeyPressed@ /end MEASUREMENT
/begin MEASUREMENT AMKFL_Current "" FLOAT64_IEEE VehCtrlMdel241025_2018b_amkspdlimit_CM_double 0 0 -1.7E+308 1.7E+308 ECU_ADDRESS @MemoryAddress@AMKFL_Current@ /end MEASUREMENT
/begin MEASUREMENT AMKFR_Current "" FLOAT64_IEEE VehCtrlMdel241025_2018b_amkspdlimit_CM_double 0 0 -1.7E+308 1.7E+308 ECU_ADDRESS @MemoryAddress@AMKFR_Current@ /end MEASUREMENT
/begin MEASUREMENT EmraxPwr "" FLOAT64_IEEE VehCtrlMdel241025_2018b_amkspdlimit_CM_double 0 0 -1.7E+308 1.7E+308 ECU_ADDRESS @MemoryAddress@EmraxPwr@ /end MEASUREMENT
/begin MEASUREMENT Trq_CUT "" FLOAT64_IEEE VehCtrlMdel241025_2018b_amkspdlimit_CM_double 0 0 -1.7E+308 1.7E+308 ECU_ADDRESS @MemoryAddress@Trq_CUT@ /end MEASUREMENT
/begin MEASUREMENT AMKSWITCH "" FLOAT64_IEEE VehCtrlMdel241025_2018b_amkspdlimit_CM_double 0 0 -1.7E+308 1.7E+308 ECU_ADDRESS @MemoryAddress@AMKSWITCH@ /end MEASUREMENT
/begin MEASUREMENT ignition "" FLOAT64_IEEE VehCtrlMdel241025_2018b_amkspdlimit_CM_double 0 0 -1.7E+308 1.7E+308 ECU_ADDRESS @MemoryAddress@ignition@ /end MEASUREMENT
/begin MEASUREMENT L12V_error "" FLOAT64_IEEE VehCtrlMdel241025_2018b_amkspdlimit_CM_double 0 0 -1.7E+308 1.7E+308 ECU_ADDRESS @MemoryAddress@L12V_error@ /end MEASUREMENT
/begin MEASUREMENT alarm "" FLOAT64_IEEE VehCtrlMdel241025_2018b_amkspdlimit_CM_double 0 0 -1.7E+308 1.7E+308 ECU_ADDRESS @MemoryAddress@alarm@ /end MEASUREMENT
/begin MEASUREMENT controller_ready "" FLOAT64_IEEE VehCtrlMdel241025_2018b_amkspdlimit_CM_double 0 0 -1.7E+308 1.7E+308 ECU_ADDRESS @MemoryAddress@controller_ready@ /end MEASUREMENT
/begin MEASUREMENT selfcheck "" FLOAT64_IEEE VehCtrlMdel241025_2018b_amkspdlimit_CM_double 0 0 -1.7E+308 1.7E+308 ECU_ADDRESS @MemoryAddress@selfcheck@ /end MEASUREMENT
/begin MEASUREMENT RPM "" FLOAT64_IEEE VehCtrlMdel241025_2018b_amkspdlimit_CM_double 0 0 -1.7E+308 1.7E+308 ECU_ADDRESS @MemoryAddress@RPM@ /end MEASUREMENT
/begin MEASUREMENT trq "" FLOAT64_IEEE VehCtrlMdel241025_2018b_amkspdlimit_CM_double 0 0 -1.7E+308 1.7E+308 ECU_ADDRESS @MemoryAddress@trq@ /end MEASUREMENT
/begin MEASUREMENT AC_current "" FLOAT64_IEEE VehCtrlMdel241025_2018b_amkspdlimit_CM_double 0 0 -1.7E+308 1.7E+308 ECU_ADDRESS @MemoryAddress@AC_current@ /end MEASUREMENT
/begin MEASUREMENT DC_current "" FLOAT64_IEEE VehCtrlMdel241025_2018b_amkspdlimit_CM_double 0 0 -1.7E+308 1.7E+308 ECU_ADDRESS @MemoryAddress@DC_current@ /end MEASUREMENT
/begin MEASUREMENT MCU_Temp "" FLOAT64_IEEE VehCtrlMdel241025_2018b_amkspdlimit_CM_double 0 0 -1.7E+308 1.7E+308 ECU_ADDRESS @MemoryAddress@MCU_Temp@ /end MEASUREMENT
/begin MEASUREMENT motor_Temp "" FLOAT64_IEEE VehCtrlMdel241025_2018b_amkspdlimit_CM_double 0 0 -1.7E+308 1.7E+308 ECU_ADDRESS @MemoryAddress@motor_Temp@ /end MEASUREMENT
/begin MEASUREMENT voltage "" FLOAT64_IEEE VehCtrlMdel241025_2018b_amkspdlimit_CM_double 0 0 -1.7E+308 1.7E+308 ECU_ADDRESS @MemoryAddress@voltage@ /end MEASUREMENT
/begin MEASUREMENT MCFR_ActualTorque "" FLOAT64_IEEE VehCtrlMdel241025_2018b_amkspdlimit_CM_double 0 0 -1.7E+308 1.7E+308 ECU_ADDRESS @MemoryAddress@MCFR_ActualTorque@ /end MEASUREMENT
/begin MEASUREMENT MCFR_ActualVelocity "" FLOAT64_IEEE VehCtrlMdel241025_2018b_amkspdlimit_CM_double 0 0 -1.7E+308 1.7E+308 ECU_ADDRESS @MemoryAddress@MCFR_ActualVelocity@ /end MEASUREMENT
/begin MEASUREMENT MCFR_DCVoltage "" FLOAT64_IEEE VehCtrlMdel241025_2018b_amkspdlimit_CM_double 0 0 -1.7E+308 1.7E+308 ECU_ADDRESS @MemoryAddress@MCFR_DCVoltage@ /end MEASUREMENT
/begin MEASUREMENT MCFR_bDCOn "" FLOAT64_IEEE VehCtrlMdel241025_2018b_amkspdlimit_CM_double 0 0 -1.7E+308 1.7E+308 ECU_ADDRESS @MemoryAddress@MCFR_bDCOn@ /end MEASUREMENT
/begin MEASUREMENT MCFR_bError "" FLOAT64_IEEE VehCtrlMdel241025_2018b_amkspdlimit_CM_double 0 0 -1.7E+308 1.7E+308 ECU_ADDRESS @MemoryAddress@MCFR_bError@ /end MEASUREMENT
/begin MEASUREMENT MCFR_bInverterOn "" FLOAT64_IEEE VehCtrlMdel241025_2018b_amkspdlimit_CM_double 0 0 -1.7E+308 1.7E+308 ECU_ADDRESS @MemoryAddress@MCFR_bInverterOn@ /end MEASUREMENT
/begin MEASUREMENT MCFR_bQuitInverterOn "" FLOAT64_IEEE VehCtrlMdel241025_2018b_amkspdlimit_CM_double 0 0 -1.7E+308 1.7E+308 ECU_ADDRESS @MemoryAddress@MCFR_bQuitInverterOn@ /end MEASUREMENT
/begin MEASUREMENT MCFR_bSystemReady "" FLOAT64_IEEE VehCtrlMdel241025_2018b_amkspdlimit_CM_double 0 0 -1.7E+308 1.7E+308 ECU_ADDRESS @MemoryAddress@MCFR_bSystemReady@ /end MEASUREMENT
/begin MEASUREMENT MCFR_TempIGBT "" FLOAT64_IEEE VehCtrlMdel241025_2018b_amkspdlimit_CM_double 0 0 -1.7E+308 1.7E+308 ECU_ADDRESS @MemoryAddress@MCFR_TempIGBT@ /end MEASUREMENT
/begin MEASUREMENT MCFR_TempInverter "" FLOAT64_IEEE VehCtrlMdel241025_2018b_amkspdlimit_CM_double 0 0 -1.7E+308 1.7E+308 ECU_ADDRESS @MemoryAddress@MCFR_TempInverter@ /end MEASUREMENT
/begin MEASUREMENT MCFR_TempMotor "" FLOAT64_IEEE VehCtrlMdel241025_2018b_amkspdlimit_CM_double 0 0 -1.7E+308 1.7E+308 ECU_ADDRESS @MemoryAddress@MCFR_TempMotor@ /end MEASUREMENT
/begin MEASUREMENT MCFR_ErrorInfo "" FLOAT64_IEEE VehCtrlMdel241025_2018b_amkspdlimit_CM_double 0 0 -1.7E+308 1.7E+308 ECU_ADDRESS @MemoryAddress@MCFR_ErrorInfo@ /end MEASUREMENT
/begin MEASUREMENT MCFL_ActualTorque "" FLOAT64_IEEE VehCtrlMdel241025_2018b_amkspdlimit_CM_double 0 0 -1.7E+308 1.7E+308 ECU_ADDRESS @MemoryAddress@MCFL_ActualTorque@ /end MEASUREMENT
/begin MEASUREMENT MCFL_ActualVelocity "" FLOAT64_IEEE VehCtrlMdel241025_2018b_amkspdlimit_CM_double 0 0 -1.7E+308 1.7E+308 ECU_ADDRESS @MemoryAddress@MCFL_ActualVelocity@ /end MEASUREMENT
/begin MEASUREMENT MCFL_DCVoltage "" FLOAT64_IEEE VehCtrlMdel241025_2018b_amkspdlimit_CM_double 0 0 -1.7E+308 1.7E+308 ECU_ADDRESS @MemoryAddress@MCFL_DCVoltage@ /end MEASUREMENT
/begin MEASUREMENT MCFL_bDCOn "" FLOAT64_IEEE VehCtrlMdel241025_2018b_amkspdlimit_CM_double 0 0 -1.7E+308 1.7E+308 ECU_ADDRESS @MemoryAddress@MCFL_bDCOn@ /end MEASUREMENT
/begin MEASUREMENT MCFL_bError "" FLOAT64_IEEE VehCtrlMdel241025_2018b_amkspdlimit_CM_double 0 0 -1.7E+308 1.7E+308 ECU_ADDRESS @MemoryAddress@MCFL_bError@ /end MEASUREMENT
/begin MEASUREMENT MCFL_bInverterOn "" FLOAT64_IEEE VehCtrlMdel241025_2018b_amkspdlimit_CM_double 0 0 -1.7E+308 1.7E+308 ECU_ADDRESS @MemoryAddress@MCFL_bInverterOn@ /end MEASUREMENT
/begin MEASUREMENT MCFL_bQuitDCOn "" FLOAT64_IEEE VehCtrlMdel241025_2018b_amkspdlimit_CM_double 0 0 -1.7E+308 1.7E+308 ECU_ADDRESS @MemoryAddress@MCFL_bQuitDCOn@ /end MEASUREMENT
/begin MEASUREMENT MCFL_bQuitInverterOn "" FLOAT64_IEEE VehCtrlMdel241025_2018b_amkspdlimit_CM_double 0 0 -1.7E+308 1.7E+308 ECU_ADDRESS @MemoryAddress@MCFL_bQuitInverterOn@ /end MEASUREMENT
/begin MEASUREMENT MCFL_bSystemReady "" FLOAT64_IEEE VehCtrlMdel241025_2018b_amkspdlimit_CM_double 0 0 -1.7E+308 1.7E+308 ECU_ADDRESS @MemoryAddress@MCFL_bSystemReady@ /end MEASUREMENT
/begin MEASUREMENT MCFL_TempIGBT "" FLOAT64_IEEE VehCtrlMdel241025_2018b_amkspdlimit_CM_double 0 0 -1.7E+308 1.7E+308 ECU_ADDRESS @MemoryAddress@MCFL_TempIGBT@ /end MEASUREMENT
/begin MEASUREMENT MCFL_TempInverter "" FLOAT64_IEEE VehCtrlMdel241025_2018b_amkspdlimit_CM_double 0 0 -1.7E+308 1.7E+308 ECU_ADDRESS @MemoryAddress@MCFL_TempInverter@ /end MEASUREMENT
/begin MEASUREMENT MCFL_TempMotor "" FLOAT64_IEEE VehCtrlMdel241025_2018b_amkspdlimit_CM_double 0 0 -1.7E+308 1.7E+308 ECU_ADDRESS @MemoryAddress@MCFL_TempMotor@ /end MEASUREMENT
/begin MEASUREMENT MCFL_ErrorInfo "" FLOAT64_IEEE VehCtrlMdel241025_2018b_amkspdlimit_CM_double 0 0 -1.7E+308 1.7E+308 ECU_ADDRESS @MemoryAddress@MCFL_ErrorInfo@ /end MEASUREMENT
/begin MEASUREMENT StrWhlAngAliveRollCnt "" FLOAT64_IEEE VehCtrlMdel241025_2018b_amkspdlimit_CM_double 0 0 -1.7E+308 1.7E+308 ECU_ADDRESS @MemoryAddress@StrWhlAngAliveRollCnt@ /end MEASUREMENT
/begin MEASUREMENT StrWhlAng "" FLOAT64_IEEE VehCtrlMdel241025_2018b_amkspdlimit_CM_double 0 0 -1.7E+308 1.7E+308 ECU_ADDRESS @MemoryAddress@StrWhlAng@ /end MEASUREMENT
/begin MEASUREMENT StrWhlAngV "" FLOAT64_IEEE VehCtrlMdel241025_2018b_amkspdlimit_CM_double 0 0 -1.7E+308 1.7E+308 ECU_ADDRESS @MemoryAddress@StrWhlAngV@ /end MEASUREMENT
/begin MEASUREMENT ABS_WS_FL "" FLOAT64_IEEE VehCtrlMdel241025_2018b_amkspdlimit_CM_double 0 0 -1.7E+308 1.7E+308 ECU_ADDRESS @MemoryAddress@ABS_WS_FL@ /end MEASUREMENT
/begin MEASUREMENT ABS_WS_FR "" FLOAT64_IEEE VehCtrlMdel241025_2018b_amkspdlimit_CM_double 0 0 -1.7E+308 1.7E+308 ECU_ADDRESS @MemoryAddress@ABS_WS_FR@ /end MEASUREMENT
/begin MEASUREMENT ABS_WS_RL "" FLOAT64_IEEE VehCtrlMdel241025_2018b_amkspdlimit_CM_double 0 0 -1.7E+308 1.7E+308 ECU_ADDRESS @MemoryAddress@ABS_WS_RL@ /end MEASUREMENT
/begin MEASUREMENT ABS_WS_RR "" FLOAT64_IEEE VehCtrlMdel241025_2018b_amkspdlimit_CM_double 0 0 -1.7E+308 1.7E+308 ECU_ADDRESS @MemoryAddress@ABS_WS_RR@ /end MEASUREMENT
/begin MEASUREMENT IMU_Ay_Value "" FLOAT64_IEEE VehCtrlMdel241025_2018b_amkspdlimit_CM_double 0 0 -1.7E+308 1.7E+308 ECU_ADDRESS @MemoryAddress@IMU_Ay_Value@ /end MEASUREMENT
/begin MEASUREMENT IMU_Ax_Value "" FLOAT64_IEEE VehCtrlMdel241025_2018b_amkspdlimit_CM_double 0 0 -1.7E+308 1.7E+308 ECU_ADDRESS @MemoryAddress@IMU_Ax_Value@ /end MEASUREMENT
/begin MEASUREMENT IMU_Yaw_Value "" FLOAT64_IEEE VehCtrlMdel241025_2018b_amkspdlimit_CM_double 0 0 -1.7E+308 1.7E+308 ECU_ADDRESS @MemoryAddress@IMU_Yaw_Value@ /end MEASUREMENT
/begin MEASUREMENT EMRAX_Trq_CUT "" FLOAT64_IEEE VehCtrlMdel241025_2018b_amkspdlimit_CM_double 0 0 -1.7E+308 1.7E+308 ECU_ADDRESS @MemoryAddress@EMRAX_Trq_CUT@ /end MEASUREMENT
/begin MEASUREMENT AMK_Trq_CUT "" FLOAT64_IEEE VehCtrlMdel241025_2018b_amkspdlimit_CM_double 0 0 -1.7E+308 1.7E+308 ECU_ADDRESS @MemoryAddress@AMK_Trq_CUT@ /end MEASUREMENT
/begin MEASUREMENT Acc_vol2 "" ULONG VehCtrlMdel241025_2018b_amkspdlimit_CM_ufix32_En16 0 0 0 65535.999984741211 ECU_ADDRESS @MemoryAddress@Acc_vol2@ /end MEASUREMENT
/begin MEASUREMENT Acc_vol "" ULONG VehCtrlMdel241025_2018b_amkspdlimit_CM_ufix32_En16 0 0 0 65535.999984741211 ECU_ADDRESS @MemoryAddress@Acc_vol@ /end MEASUREMENT
/begin MEASUREMENT Acc_POS "" ULONG VehCtrlMdel241025_2018b_amkspdlimit_CM_ufix32_En16 0 0 0 65535.999984741211 ECU_ADDRESS @MemoryAddress@Acc_POS@ /end MEASUREMENT
/begin MEASUREMENT Acc_POS2 "" ULONG VehCtrlMdel241025_2018b_amkspdlimit_CM_ufix32_En16 0 0 0 65535.999984741211 ECU_ADDRESS @MemoryAddress@Acc_POS2@ /end MEASUREMENT
/begin MEASUREMENT VehVxEst_mps "" FLOAT32_IEEE VehCtrlMdel241025_2018b_amkspdlimit_CM_single 0 0 -3.4E+38 3.4E+38 ECU_ADDRESS @MemoryAddress@VehVxEst_mps@ /end MEASUREMENT
/begin MEASUREMENT PwrALL "" FLOAT32_IEEE VehCtrlMdel241025_2018b_amkspdlimit_CM_single 0 0 -3.4E+38 3.4E+38 ECU_ADDRESS @MemoryAddress@PwrALL@ /end MEASUREMENT
/begin MEASUREMENT EmraxTrqR_cmd "" FLOAT32_IEEE VehCtrlMdel241025_2018b_amkspdlimit_CM_single 0 0 -3.4E+38 3.4E+38 ECU_ADDRESS @MemoryAddress@EmraxTrqR_cmd@ /end MEASUREMENT
/begin MEASUREMENT AMKTrqFR_cmd "" FLOAT32_IEEE VehCtrlMdel241025_2018b_amkspdlimit_CM_single 0 0 -3.4E+38 3.4E+38 ECU_ADDRESS @MemoryAddress@AMKTrqFR_cmd@ /end MEASUREMENT
/begin MEASUREMENT AMKTrqFL_cmd "" FLOAT32_IEEE VehCtrlMdel241025_2018b_amkspdlimit_CM_single 0 0 -3.4E+38 3.4E+38 ECU_ADDRESS @MemoryAddress@AMKTrqFL_cmd@ /end MEASUREMENT
/begin MEASUREMENT F_BrkPrs "" UWORD VehCtrlMdel241025_2018b_amkspdlimit_CM_uint16 0 0 0 65535 ECU_ADDRESS @MemoryAddress@F_BrkPrs@ /end MEASUREMENT
/begin MEASUREMENT Acc1 "" UWORD VehCtrlMdel241025_2018b_amkspdlimit_CM_uint16 0 0 0 65535 ECU_ADDRESS @MemoryAddress@Acc1@ /end MEASUREMENT
/begin MEASUREMENT Acc2 "" UWORD VehCtrlMdel241025_2018b_amkspdlimit_CM_uint16 0 0 0 65535 ECU_ADDRESS @MemoryAddress@Acc2@ /end MEASUREMENT
/begin MEASUREMENT Brk1 "" UWORD VehCtrlMdel241025_2018b_amkspdlimit_CM_uint16 0 0 0 65535 ECU_ADDRESS @MemoryAddress@Brk1@ /end MEASUREMENT
/begin MEASUREMENT Brk2 "" UWORD VehCtrlMdel241025_2018b_amkspdlimit_CM_uint16 0 0 0 65535 ECU_ADDRESS @MemoryAddress@Brk2@ /end MEASUREMENT
/begin MEASUREMENT STATEDISPLAY "" UBYTE VehCtrlMdel241025_2018b_amkspdlimit_CM_boolean 0 0 0 1 ECU_ADDRESS @MemoryAddress@STATEDISPLAY@ /end MEASUREMENT
/begin MEASUREMENT HVSWITCH "" UBYTE VehCtrlMdel241025_2018b_amkspdlimit_CM_boolean 0 0 0 1 ECU_ADDRESS @MemoryAddress@HVSWITCH@ /end MEASUREMENT
/begin MEASUREMENT TSAL_SW_IN "" UBYTE VehCtrlMdel241025_2018b_amkspdlimit_CM_boolean 0 0 0 1 ECU_ADDRESS @MemoryAddress@TSAL_SW_IN@ /end MEASUREMENT
/begin MEASUREMENT HV_voltValid "" UBYTE VehCtrlMdel241025_2018b_amkspdlimit_CM_boolean 0 0 0 1 ECU_ADDRESS @MemoryAddress@HV_voltValid@ /end MEASUREMENT
/begin MEASUREMENT Brk "" UBYTE VehCtrlMdel241025_2018b_amkspdlimit_CM_boolean 0 0 0 1 ECU_ADDRESS @MemoryAddress@Brk@ /end MEASUREMENT
/begin MEASUREMENT ACC_Release "" UBYTE VehCtrlMdel241025_2018b_amkspdlimit_CM_boolean 0 0 0 1 ECU_ADDRESS @MemoryAddress@ACC_Release@ /end MEASUREMENT
/begin MEASUREMENT beeper_state "" UBYTE VehCtrlMdel241025_2018b_amkspdlimit_CM_boolean 0 0 0 1 ECU_ADDRESS @MemoryAddress@beeper_state@ /end MEASUREMENT
/begin MEASUREMENT MCFL_DCOn_setpoints "" UBYTE VehCtrlMdel241025_2018b_amkspdlimit_CM_boolean 0 0 0 1 ECU_ADDRESS @MemoryAddress@MCFL_DCOn_setpoints@ /end MEASUREMENT
/begin MEASUREMENT MCFR_DCEnable "" UBYTE VehCtrlMdel241025_2018b_amkspdlimit_CM_boolean 0 0 0 1 ECU_ADDRESS @MemoryAddress@MCFR_DCEnable@ /end MEASUREMENT
/begin MEASUREMENT MCFR_InverterOn "" UBYTE VehCtrlMdel241025_2018b_amkspdlimit_CM_boolean 0 0 0 1 ECU_ADDRESS @MemoryAddress@MCFR_InverterOn@ /end MEASUREMENT
/begin MEASUREMENT TrqR_cmd_raw "" UBYTE VehCtrlMdel241025_2018b_amkspdlimit_CM_boolean 0 0 0 1 ECU_ADDRESS @MemoryAddress@TrqR_cmd_raw@ /end MEASUREMENT
/begin MEASUREMENT TroqueOn "" UBYTE VehCtrlMdel241025_2018b_amkspdlimit_CM_boolean 0 0 0 1 ECU_ADDRESS @MemoryAddress@TroqueOn@ /end MEASUREMENT
/begin MEASUREMENT Trq_CUT_final "" UBYTE VehCtrlMdel241025_2018b_amkspdlimit_CM_boolean 0 0 0 1 ECU_ADDRESS @MemoryAddress@Trq_CUT_final@ /end MEASUREMENT
/begin COMPU_METHOD VehCtrlMdel241025_2018b_amkspdlimit_CM_double "Q = V" RAT_FUNC "%15.10" "" COEFFS 0 1 0 0 0 1 /end COMPU_METHOD
/begin COMPU_METHOD VehCtrlMdel241025_2018b_amkspdlimit_CM_boolean "Q = V" RAT_FUNC "%1.0" "" COEFFS 0 1 0 0 0 1 /end COMPU_METHOD
/begin COMPU_METHOD VehCtrlMdel241025_2018b_amkspdlimit_CM_ufix32_En16 "Q = V*65536.000000" RAT_FUNC "%26.16" "" COEFFS 0 65536.000000 0.000000 0 0 1.000000 /end COMPU_METHOD
/begin COMPU_METHOD VehCtrlMdel241025_2018b_amkspdlimit_CM_single "Q = V" RAT_FUNC "%8.6" "" COEFFS 0 1 0 0 0 1 /end COMPU_METHOD
/begin COMPU_METHOD VehCtrlMdel241025_2018b_amkspdlimit_CM_uint16 "Q = V" RAT_FUNC "%5.0" "" COEFFS 0 1 0 0 0 1 /end COMPU_METHOD
/begin GROUP VehCtrlMdel241025_2018b_amkspdlimit "VehCtrlMdel241025_2018b_amkspdlimit" /* Root */ ROOT
 /begin SUB_GROUP Root_CTRL Root_Drive_Ready Root_Input Root_Input_Processing Root_OUTPUT /end SUB_GROUP
 /begin REF_MEASUREMENT AMK_Trq_CUT EMRAX_Trq_CUT VehCtrlMdel241025_2018b_amksp_B.AMKSWITCH_bx VehCtrlMdel241025_2018b_amksp_B.HV_voltValid_kx VehCtrlMdel241025_2018b_amksp_B.ModeSW_o VehCtrlMdel241025_2018b_amksp_B.TSAL_SW_IN_i2 VehCtrlMdel241025_2018b_amksp_B.ignition_d VehCtrlMdel241025_2018b_amksp_B.out2_h /end REF_MEASUREMENT
/end GROUP
/begin GROUP Root_CTRL "VehCtrlMdel241025_2018b_amkspdlimit/CTRL" /begin SUB_GROUP S1_MoTrqReq /end SUB_GROUP /end GROUP
/begin GROUP Root_Drive_Ready "VehCtrlMdel241025_2018b_amkspdlimit/Drive_Ready" /begin SUB_GROUP S2_Subsystem /end SUB_GROUP /end GROUP
/begin GROUP Root_Input "VehCtrlMdel241025_2018b_amkspdlimit/Input"
 /begin SUB_GROUP S3_ABS_Receive S3_AMKMCU_Receive S3_AccBrk_BUS S3_EMRAXMCU_RECIEVE S3_IMU_Recieve S3_StrSnis_Receive S3_key /end SUB_GROUP
/end GROUP
/begin GROUP Root_Input_Processing "VehCtrlMdel241025_2018b_amkspdlimit/Input_Processing" /begin SUB_GROUP S4_Function_Call_Subsystem S4_Subsystem /end SUB_GROUP /end GROUP
/begin GROUP Root_OUTPUT "VehCtrlMdel241025_2018b_amkspdlimit/OUTPUT" /begin SUB_GROUP S5_Beeper S5_VCU2EmraxMCU /end SUB_GROUP /end GROUP
/begin GROUP S1_MoTrqReq "VehCtrlMdel241025_2018b_amkspdlimit/CTRL/MoTrqReq" /begin SUB_GROUP S7_Subsystem /end SUB_GROUP
 /begin REF_MEASUREMENT AMKTrqFL_cmd AMKTrqFR_cmd EmraxTrqR_cmd TroqueOn TrqR_cmd_raw Trq_CUT_final /end REF_MEASUREMENT
/end GROUP
/begin GROUP S2_Subsystem "VehCtrlMdel241025_2018b_amkspdlimit/Drive_Ready/Subsystem"
 /begin REF_MEASUREMENT ACC_Release Brk MCFL_DCOn_setpoints MCFR_DCEnable MCFR_InverterOn beeper_state /end REF_MEASUREMENT
/end GROUP
/begin GROUP S3_ABS_Receive "VehCtrlMdel241025_2018b_amkspdlimit/Input/ABS_Receive" /begin SUB_GROUP S123_ABS_BUS_state /end SUB_GROUP /end GROUP
/begin GROUP S3_AMKMCU_Receive "VehCtrlMdel241025_2018b_amkspdlimit/Input/AMKMCU_Receive" /begin SUB_GROUP S124_FLAMKMCU S124_FRAMKMCU /end SUB_GROUP /end GROUP
/begin GROUP S3_AccBrk_BUS "VehCtrlMdel241025_2018b_amkspdlimit/Input/AccBrk_BUS" /begin REF_MEASUREMENT Acc1 Acc2 Brk1 Brk2 /end REF_MEASUREMENT /end GROUP
/begin GROUP S3_EMRAXMCU_RECIEVE "VehCtrlMdel241025_2018b_amkspdlimit/Input/EMRAXMCU_RECIEVE" /begin SUB_GROUP S127_MCU_pwr S127_MCU_state /end SUB_GROUP /end GROUP
/begin GROUP S3_IMU_Recieve "VehCtrlMdel241025_2018b_amkspdlimit/Input/IMU_Recieve" /begin SUB_GROUP S128_IMU_state /end SUB_GROUP /end GROUP
/begin GROUP S3_StrSnis_Receive "VehCtrlMdel241025_2018b_amkspdlimit/Input/StrSnis_Receive" /begin SUB_GROUP S129_StrWhSnis_state /end SUB_GROUP /end GROUP
/begin GROUP S3_key "VehCtrlMdel241025_2018b_amkspdlimit/Input/key" /begin REF_MEASUREMENT AMKSWITCH HV_voltValid TSAL_SW_IN ignition /end REF_MEASUREMENT /end GROUP
/begin GROUP S4_Function_Call_Subsystem "VehCtrlMdel241025_2018b_amkspdlimit/Input_Processing/Function-Call Subsystem" /begin SUB_GROUP S215_AccBrkPedal S215_Subsystem /end SUB_GROUP /begin REF_MEASUREMENT KeyPressed /end REF_MEASUREMENT /end GROUP
/begin GROUP S4_Subsystem "VehCtrlMdel241025_2018b_amkspdlimit/Input_Processing/Subsystem" /begin SUB_GROUP S216_WhlSpdSelect /end SUB_GROUP /end GROUP
/begin GROUP S5_Beeper "VehCtrlMdel241025_2018b_amkspdlimit/OUTPUT/Beeper" /begin REF_MEASUREMENT HVSWITCH STATEDISPLAY /end REF_MEASUREMENT /end GROUP
/begin GROUP S5_VCU2EmraxMCU "VehCtrlMdel241025_2018b_amkspdlimit/OUTPUT/VCU2EmraxMCU" /begin REF_MEASUREMENT Gear_Trs Mode_Trs /end REF_MEASUREMENT /end GROUP
/begin GROUP S7_Subsystem "VehCtrlMdel241025_2018b_amkspdlimit/CTRL/MoTrqReq/Subsystem" /begin REF_MEASUREMENT PwrALL /end REF_MEASUREMENT /end GROUP
/begin GROUP S123_ABS_BUS_state "VehCtrlMdel241025_2018b_amkspdlimit/Input/ABS_Receive/ABS_BUS_state" /begin SUB_GROUP S131_IMU_state /end SUB_GROUP /end GROUP
/begin GROUP S124_FLAMKMCU "VehCtrlMdel241025_2018b_amkspdlimit/Input/AMKMCU_Receive/FLAMKMCU" /begin SUB_GROUP S137_AMKMCU_state S137_AMKMCU_state1 S137_AMKMCU_state2 /end SUB_GROUP /end GROUP
/begin GROUP S124_FRAMKMCU "VehCtrlMdel241025_2018b_amkspdlimit/Input/AMKMCU_Receive/FRAMKMCU" /begin SUB_GROUP S138_AMKMCU_state S138_AMKMCU_state1 S138_AMKMCU_state2 /end SUB_GROUP /end GROUP
/begin GROUP S127_MCU_pwr "VehCtrlMdel241025_2018b_amkspdlimit/Input/EMRAXMCU_RECIEVE/MCU_pwr" /begin SUB_GROUP S182_MCU_VCUMeter1 /end SUB_GROUP /end GROUP
/begin GROUP S127_MCU_state "VehCtrlMdel241025_2018b_amkspdlimit/Input/EMRAXMCU_RECIEVE/MCU_state" /begin SUB_GROUP S183_MCU_state /end SUB_GROUP /end GROUP
/begin GROUP S128_IMU_state "VehCtrlMdel241025_2018b_amkspdlimit/Input/IMU_Recieve/IMU_state" /begin SUB_GROUP S197_MCU_state /end SUB_GROUP /end GROUP
/begin GROUP S129_StrWhSnis_state "VehCtrlMdel241025_2018b_amkspdlimit/Input/StrSnis_Receive/StrWhSnis_state" /begin SUB_GROUP S202_IMU_state /end SUB_GROUP /end GROUP
/begin GROUP S215_AccBrkPedal "VehCtrlMdel241025_2018b_amkspdlimit/Input_Processing/Function-Call Subsystem/AccBrkPedal" /begin REF_MEASUREMENT Acc_POS Acc_POS2 Acc_vol Acc_vol2 F_BrkPrs Trq_CUT /end REF_MEASUREMENT /end GROUP
/begin GROUP S215_Subsystem "VehCtrlMdel241025_2018b_amkspdlimit/Input_Processing/Function-Call Subsystem/Subsystem" /begin REF_MEASUREMENT AMKFL_Current AMKFR_Current EmraxPwr /end REF_MEASUREMENT /end GROUP
/begin GROUP S216_WhlSpdSelect "VehCtrlMdel241025_2018b_amkspdlimit/Input_Processing/Subsystem/WhlSpdSelect" /begin SUB_GROUP S288_Filter /end SUB_GROUP /end GROUP
/begin GROUP S131_IMU_state "VehCtrlMdel241025_2018b_amkspdlimit/Input/ABS_Receive/ABS_BUS_state/IMU_state" /begin REF_MEASUREMENT ABS_WS_FL ABS_WS_FR ABS_WS_RL ABS_WS_RR /end REF_MEASUREMENT /end GROUP
/begin GROUP S137_AMKMCU_state "VehCtrlMdel241025_2018b_amkspdlimit/Input/AMKMCU_Receive/FLAMKMCU/AMKMCU_state" /begin SUB_GROUP S139_MCU_state /end SUB_GROUP /end GROUP
/begin GROUP S137_AMKMCU_state1 "VehCtrlMdel241025_2018b_amkspdlimit/Input/AMKMCU_Receive/FLAMKMCU/AMKMCU_state1" /begin SUB_GROUP S140_MCU_state /end SUB_GROUP /end GROUP
/begin GROUP S137_AMKMCU_state2 "VehCtrlMdel241025_2018b_amkspdlimit/Input/AMKMCU_Receive/FLAMKMCU/AMKMCU_state2" /begin SUB_GROUP S141_MCU_state /end SUB_GROUP /end GROUP
/begin GROUP S138_AMKMCU_state "VehCtrlMdel241025_2018b_amkspdlimit/Input/AMKMCU_Receive/FRAMKMCU/AMKMCU_state" /begin SUB_GROUP S158_MCU_state /end SUB_GROUP /end GROUP
/begin GROUP S138_AMKMCU_state1 "VehCtrlMdel241025_2018b_amkspdlimit/Input/AMKMCU_Receive/FRAMKMCU/AMKMCU_state1" /begin SUB_GROUP S159_MCU_state /end SUB_GROUP /end GROUP
/begin GROUP S138_AMKMCU_state2 "VehCtrlMdel241025_2018b_amkspdlimit/Input/AMKMCU_Receive/FRAMKMCU/AMKMCU_state2" /begin SUB_GROUP S160_MCU_state /end SUB_GROUP /end GROUP
/begin GROUP S182_MCU_VCUMeter1 "VehCtrlMdel241025_2018b_amkspdlimit/Input/EMRAXMCU_RECIEVE/MCU_pwr/MCU_VCUMeter1" /begin REF_MEASUREMENT AC_current DC_current MCU_Temp motor_Temp voltage /end REF_MEASUREMENT /end GROUP
/begin GROUP S183_MCU_state "VehCtrlMdel241025_2018b_amkspdlimit/Input/EMRAXMCU_RECIEVE/MCU_state/MCU_state" /begin REF_MEASUREMENT L12V_error RPM alarm controller_ready selfcheck trq /end REF_MEASUREMENT /end GROUP
/begin GROUP S197_MCU_state "VehCtrlMdel241025_2018b_amkspdlimit/Input/IMU_Recieve/IMU_state/MCU_state" /begin REF_MEASUREMENT IMU_Ax_Value IMU_Ay_Value IMU_Yaw_Value /end REF_MEASUREMENT /end GROUP
/begin GROUP S202_IMU_state "VehCtrlMdel241025_2018b_amkspdlimit/Input/StrSnis_Receive/StrWhSnis_state/IMU_state" /begin REF_MEASUREMENT StrWhlAng StrWhlAngAliveRollCnt StrWhlAngV /end REF_MEASUREMENT /end GROUP
/begin GROUP S288_Filter "VehCtrlMdel241025_2018b_amkspdlimit/Input_Processing/Subsystem/WhlSpdSelect/Filter" /begin REF_MEASUREMENT VehVxEst_mps /end REF_MEASUREMENT /end GROUP
/begin GROUP S139_MCU_state "VehCtrlMdel241025_2018b_amkspdlimit/Input/AMKMCU_Receive/FLAMKMCU/AMKMCU_state/MCU_state"
 /begin REF_MEASUREMENT MCFL_ActualTorque MCFL_ActualVelocity MCFL_DCVoltage MCFL_bDCOn MCFL_bError MCFL_bInverterOn MCFL_bQuitDCOn MCFL_bQuitInverterOn MCFL_bSystemReady /end REF_MEASUREMENT
/end GROUP
/begin GROUP S140_MCU_state "VehCtrlMdel241025_2018b_amkspdlimit/Input/AMKMCU_Receive/FLAMKMCU/AMKMCU_state1/MCU_state" /begin REF_MEASUREMENT MCFL_ErrorInfo /end REF_MEASUREMENT /end GROUP
/begin GROUP S141_MCU_state "VehCtrlMdel241025_2018b_amkspdlimit/Input/AMKMCU_Receive/FLAMKMCU/AMKMCU_state2/MCU_state" /begin REF_MEASUREMENT MCFL_TempIGBT MCFL_TempInverter MCFL_TempMotor /end REF_MEASUREMENT /end GROUP
/begin GROUP S158_MCU_state "VehCtrlMdel241025_2018b_amkspdlimit/Input/AMKMCU_Receive/FRAMKMCU/AMKMCU_state/MCU_state"
 /begin REF_MEASUREMENT MCFR_ActualTorque MCFR_ActualVelocity MCFR_DCVoltage MCFR_bDCOn MCFR_bError MCFR_bInverterOn MCFR_bQuitInverterOn MCFR_bSystemReady /end REF_MEASUREMENT
/end GROUP
/begin GROUP S159_MCU_state "VehCtrlMdel241025_2018b_amkspdlimit/Input/AMKMCU_Receive/FRAMKMCU/AMKMCU_state1/MCU_state" /begin REF_MEASUREMENT MCFR_ErrorInfo /end REF_MEASUREMENT /end GROUP
/begin GROUP S160_MCU_state "VehCtrlMdel241025_2018b_amkspdlimit/Input/AMKMCU_Receive/FRAMKMCU/AMKMCU_state2/MCU_state" /begin REF_MEASUREMENT MCFR_TempIGBT MCFR_TempInverter MCFR_TempMotor /end REF_MEASUREMENT /end GROUP
/end MODULE
/end PROJECT
/* (add any file trailer comments here) */
/* EOF VehCtrlMdel241025_2018b_amkspdlimit.a2l */
